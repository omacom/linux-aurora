## drivers/pmdomain/apple/Kconfig
```kconfig
# SPDX-License-Identifier: GPL-2.0-only

if ARCH_APPLE || COMPILE_TEST

config APPLE_PMGR_PWRSTATE
	bool "Apple SoC PMGR power state control"
	depends on PM
	select REGMAP
	select MFD_SYSCON
	select PM_GENERIC_DOMAINS
	select RESET_CONTROLLER
	help
	  The PMGR block in Apple SoCs provides high-level power state
	  controls for SoC devices. This driver manages them through the
	  generic power domain framework, and also provides reset support.

config APPLE_PMGR_PWRSTATE_KUNIT_TEST
	bool "KUnit tests for the Apple PMGR power state driver" if !KUNIT_ALL_TESTS
	depends on APPLE_PMGR_PWRSTATE && KUNIT=y
	default KUNIT_ALL_TESTS
	help
	  Check that a domain marked apple,no-auto-pm never gets automatic
	  power management when it is powered on or when a failed power-off
	  is undone, and that other domains still do. The tests run the
	  driver's power callbacks against an emulated power state register
	  and need no Apple hardware.

config APPLE_PMGR_PSD
	bool "Apple T8152 PSD service slot power domains"
	default ARCH_APPLE
	depends on OF
	depends on PM
	select PM_GENERIC_DOMAINS
	help
	  The M6 (T8152) power state director gates the ATC USB blocks behind a
	  per-port service slot request on top of the PMGR power states. This
	  driver exposes each slot as a power domain whose parents are the PMGR
	  domains, so consumers (the USB DARTs and controllers) power both in order.

config APPLE_PMP_REPORT
	bool "Apple PMP report control"
	depends on OF
	depends on PM
	select PM_GENERIC_DOMAINS
	select OF_DYNAMIC
	help
	  Power domains for the SoC device power requests that the power
	  management processor (PMP) of some Apple SoCs takes from the
	  report region it shares with the system, and the PMP's report of
	  its own state.

	  On T8122 (M3), T6031 (M3 Max), and opted-in T6030 (M3 Pro) Macs
	  whose boot loader hands the
	  internal display over (see APPLE_T6030_DISPLAY_GATE), iBoot leaves
	  the PMP halted, and this driver starts it when the display driver
	  first asks for it. Once its nodes are enabled the PMP may run until
	  the next reboot. That holds when the start then fails, too (the PMP
	  driver does not bind, or the PMP does not report ready or does not
	  acknowledge the startup requests): nothing stops the PMP, this
	  driver does not check the SoC's power or temperature afterwards,
	  and the display stays on the boot framebuffer. There is no safe
	  way to stop the PMP short of a reboot, so reboot. To boot without starting the PMP, put
	  apple_t8122_display.enable=0 (T8122) or nomodeset on the kernel
	  command line; on T6031 it is only started with
	  apple_t6031_display.enable=1. The start's state is in debugfs, in
	  apple-pmp-report/<report device>.

config APPLE_PMC
	bool "Apple PMC voter interface"
	depends on OF
	depends on PM
	select PM_GENERIC_DOMAINS
	default ARCH_APPLE
	help
	  The PMC in some Apple SoCs arbitrates the performance states of
	  shared rails, such as the DRAM controller and the SoC fabric,
	  between voter agents. This driver enables the static agents and
	  provides power domains that enable a dynamic agent, such as the
	  GPU, while its device is powered on. It can also limit the DRAM
	  controller rail as a thermal cooling device.

config APPLE_PMC_KUNIT_TEST
	bool "KUnit tests for the Apple PMC voter interface" if !KUNIT_ALL_TESTS
	depends on APPLE_PMC && KUNIT=y
	default KUNIT_ALL_TESTS
	help
	  Unit tests for the Apple PMC driver. They check that enabling and
	  disabling a voter agent only changes that agent on each rail, and
	  that lifting a DCS limit gives the AP agent its own vote back. The
	  registers are simulated in memory. Only useful for kernel developers.

config APPLE_PMP_REPORT_START_KUNIT_TEST
	bool "KUnit tests for starting a halted Apple PMP" if !KUNIT_ALL_TESTS
	depends on APPLE_PMP_REPORT && KUNIT=y
	default KUNIT_ALL_TESTS
	help
	  Injects faults into the start of a halted PMP (APPLE_PMP_REPORT):
	  failed checks, a PMP driver that does not bind, a PMP that does not
	  report ready or acknowledge its startup requests, consumers that
	  time out, and the teardown of the report and its entries while a
	  start or a consumer waits. The report region is simulated in
	  memory. Only useful for kernel developers.

endif

config APPLE_PMP_REPORT_KUNIT_TEST
	tristate "Apple PMP report validation tests" if !KUNIT_ALL_TESTS
	depends on KUNIT && PM
	select PM_GENERIC_DOMAINS
	default KUNIT_ALL_TESTS
	help
	  Tests the PMP report layout, request acknowledgment flags and boot
	  argument validation without accessing hardware.
	  Includes malformed tables, address arithmetic and device ordering.
	  The PMP report driver does not need to be enabled to run this suite.
```

## drivers/soc/apple/Kconfig
```kconfig
# SPDX-License-Identifier: GPL-2.0-only

if ARCH_APPLE || COMPILE_TEST

menu "Apple SoC drivers"

config APPLE_DOCKCHANNEL
	tristate "Apple DockChannel FIFO"
	depends on ARCH_APPLE || COMPILE_TEST
	help
	  DockChannel is a simple FIFO used on Apple SoCs for debug and inter-processor
	  communications.

	  Say 'y' here if you have an Apple SoC.

config APPLE_MAILBOX
	tristate "Apple SoC mailboxes"
	depends on PM
	depends on ARCH_APPLE || (64BIT && COMPILE_TEST)
	help
	  Apple SoCs have various co-processors required for certain
	  peripherals to work (NVMe, display controller, etc.). This
	  driver adds support for the mailbox controller used to
	  communicate with those.

	  Say Y here if you have an Apple SoC.

config APPLE_MCC
	tristate "Apple T8140 system level cache"
	depends on ARCH_APPLE || COMPILE_TEST
	depends on OF
	default ARCH_APPLE
	help
	  The boot firmware of the Apple T8140 SoC enables the system level
	  cache without letting it allocate. This driver allows allocation
	  once the devices that took over DMA from the bootloader are bound.

	  Say 'y' or 'm' here if you have an Apple T8140 SoC.

config APPLE_MCC_KUNIT_TEST
	bool "KUnit tests for Apple MCC allocation and unwind" if !KUNIT_ALL_TESTS
	depends on APPLE_MCC=y && KUNIT=y
	default KUNIT_ALL_TESTS
	help
	  Test allocation failure after a plane has been enabled, and cache
	  handoff on shutdown, using simulated registers. Verify that failure
	  also cleans up the plane whose state is uncertain. These tests do not
	  access physical hardware and are only useful for kernel developers.

config APPLE_PMGR_MISC
	bool "Apple SoC PMGR miscellaneous support"
	depends on PM
	help
	  The PMGR block in Apple SoCs provides high-level power state
	  controls for SoC devices. This driver manages miscellaneous
	  power controls.

config APPLE_RTKIT
	tristate "Apple RTKit co-processor IPC protocol"
	depends on APPLE_MAILBOX
	depends on ARCH_APPLE || COMPILE_TEST
	help
	  Apple SoCs such as the M1 come with various co-processors running
	  their proprietary RTKit operating system. This option enables support
	  for the protocol library used to communicate with those. It is used
	  by various client drivers.

	  Say 'y' here if you have an Apple SoC.

config APPLE_RTKIT_HELPER
	tristate "Apple Generic RTKit helper co-processor"
	depends on APPLE_RTKIT
	depends on ARCH_APPLE || COMPILE_TEST
	help
	  Apple SoCs such as the M1 come with various co-processors running
	  their proprietary RTKit operating system. This option enables support
	  for a generic co-processor that does not implement any additional
	  in-band communications. It can be used for testing purposes, or for
	  coprocessors such as MTP that communicate over a different interface.

	  Say 'y' here if you have an Apple SoC.

config APPLE_SART
	tristate "Apple SART DMA address filter"
	depends on ARCH_APPLE || COMPILE_TEST
	help
	  Apple SART is a simple DMA address filter used on Apple SoCs such
	  as the M1. It is usually required for the NVMe coprocessor which does
	  not use a proper IOMMU.

	  Say 'y' here if you have an Apple SoC.

config APPLE_TUNABLE
	tristate
	depends on ARCH_APPLE || COMPILE_TEST

config RUST_APPLE_MAILBOX
	bool
	depends on PM
	depends on RUST
	select APPLE_MAILBOX

config RUST_APPLE_RTKIT
	bool
	depends on PM
	depends on RUST
	select APPLE_RTKIT
	select RUST_APPLE_MAILBOX

config APPLE_AOP
	tristate "Apple \"Always-on\" Processor"
	depends on ARCH_APPLE || COMPILE_TEST
	depends on PM
	depends on RUST
	select RUST_APPLE_RTKIT
	select RUST_APPLE_MAILBOX
	select RUST_FW_LOADER_ABSTRACTIONS
	help
	  A co-processor persent on certain Apple SoCs controlling accelerometers,
	  gyros, ambient light sensors and microphones. Is not actually always on.

	  Say 'y' here if you have an Apple laptop.

config APPLE_SEP_FV_INTERFACE
	bool

config APPLE_SEP
	tristate "Apple SEP (Secure Enclave Processor)"
	default m if ARCH_APPLE
	depends on ARCH_APPLE
	depends on PM
	depends on RUST
	depends on DMA_SHARED_BUFFER
	depends on OF_DYNAMIC
	depends on SPI
	depends on RUST_APPLE_MAILBOX
	depends on HW_RANDOM
	depends on TRUSTED_KEYS
	depends on CRYPTO
	depends on MFD_MACSMC || !MFD_MACSMC
	select CRYPTO_HMAC
	select CRYPTO_SHA256
	select CRYPTO_AES
	select CRYPTO_GCM
	select CRYPTO_ECDH
	select APPLE_SEP_FV_INTERFACE
	select RUST_FW_LOADER_ABSTRACTIONS
	help
	  Driver for the Apple SEP (Secure Enclave Processor) on Apple silicon.
	  It drives the Touch ID fingerprint sensor over a /dev/sep-bio character
	  device (enrol and match), exposes the SEP hardware RNG, and registers a
	  SEP-backed trusted key source so keyctl can seal keys to the enclave.

	  The driver reads the existing machine-wide xART gigalocker directly from
	  the iBoot system container, locating its .gl extent through read-only,
	  checksum-validated APFS metadata. It validates the complete store and
	  both root records before registering with SEP.
	  xART writes are enabled by default, but accepted only when the driver
	  validates the physical extent ownership invariants. Unsupported APFS
	  layouts fail closed. A Linux identity keybag is created automatically
	  when none exists; existing identities and reference keys are retained.
	  Set xart_writes=0 provision_keybag=0 for read-only operation.
	  With writes off the driver still attaches, but refuses Touch ID enrol
	  and verify: the enclave saves anti-replay state after every match.

	  Say Y here if you have an Apple silicon Mac.

config APPLE_SEP_KUNIT_TEST
	bool "KUnit tests for the Apple SEP driver" if !KUNIT_ALL_TESTS
	depends on APPLE_SEP && KUNIT
	default KUNIT_ALL_TESTS
	help
	  Build KUnit tests for the pure logic of the Apple SEP driver: the
	  mailbox message encoding and decoding, the shared-memory registration
	  limits, the rules that keep a keybag's lookup identity apart from
	  the identity the enclave reports, the format and validation of the
	  Linux host-state store, and the xART guard's decisions and its list
	  of Linux's records. The tests touch no hardware.

	  If unsure, say N.

config APPLE_PMP
	tristate "Apple Power Management Processor"
	depends on ARCH_APPLE || COMPILE_TEST
	depends on RUST
	select APPLE_PMP_REPORT
	select RUST_APPLE_RTKIT
	default y if ARCH_APPLE
	help
	  A co-processor present on Apple SoCs, controlling power states of
	  fabric and other uncore components.

	  Say 'y' here if you have an Apple SoC.

config APPLE_CLPC
	tristate "Apple host performance controller floors"
	depends on ARCH_APPLE || COMPILE_TEST
	depends on APPLE_PMC && CPU_FREQ
	default ARCH_APPLE
	help
	  Raises the DRAM controller and SoC fabric performance floors of the
	  host's PMC voter agent while CPU clusters are busy, and releases
	  them at idle.

	  Say 'y' or 'm' here if you have an Apple SoC with a PMC.

config APPLE_T6030_DISPLAY_GATE
	bool "Apple T6030 internal display enable gate"
	depends on ARCH_APPLE && OF_DYNAMIC && OF_OVERLAY
	default ARCH_APPLE
	help
	  The T6030 device tree keeps the internal display nodes disabled so
	  the display stays on the boot framebuffer until the boot loader has
	  validated the display handoff. This option enables those nodes
	  before devices are created once the boot loader has marked the
	  handoff as validated, and adds the power management processor
	  from a built-in overlay, with the values the boot loader passes
	  for this Mac (or, on a J516S whose boot loader passes none,
	  built-in ones). Without them it does nothing.
	  apple_t6030_display.enable=0 keeps the boot framebuffer.

	  The same gate serves T8122 (M3) device trees with
	  apple,t8122-handoff. There it adds no overlay: it completes the PMP,
	  report and requests the device tree describes, with the values the
	  boot loader passes, and the PMP report driver starts the PMP. It
	  enables the T8122 external display processor only when the boot
	  loader has marked it apple,t8122-dcpext-firmware-ready, and not with
	  nomodeset.

	  It also serves T6031 (M3 Max) device trees with apple,t6031-handoff,
	  in the same way and only with the PMP values the boot loader passes.
	  There the native display is on by default on the J516C, unless
	  apple_t6031_display.enable=0; the other T6031 boards need
	  apple_t6031_display.enable=1 on the kernel command line. The T6031
	  GPU driver starts its firmware only after this native display is
	  up, so apple_t6031_display.enable=0, or a native display that does
	  not come up, also keeps the GPU off for that boot. It is not a
	  display-only switch.

	  Say 'y' if you want the native display on M3 Pro MacBook Pros.

config APPLE_T8122_GPU_PMP_LINK
	bool
	depends on APPLE_PMP_REPORT
	default n
	help
	  Let T8122 (M3 MacBook Air) GPU power commands wait for the display
	  request the PMP report acknowledges on the 14.8.3 firmware, as the
	  M3 runtime of DRM_ASAHI_M3_T8122 requires.

config APPLE_T6030_GPU_PMP_LINK
	bool
	depends on APPLE_T6030_DISPLAY_GATE
	default n
	help
	  Link an opted-in T6030 GPU to the PMP admitted by the display gate.
	  GPU power commands wait for that supplier's acknowledged display
	  request through the existing PMP report startup and removal rules.

config APPLE_T6031_GPU_PMP_REPORT
	bool
	depends on APPLE_PMP_REPORT
	default n
	help
	  Set the AGX request of the T6031 (M3 Max) PMP report once the G15
	  firmware runs. The T6031 GPU is powered by its PMGR domain alone, so
	  nothing else sets that request, and without it the PMP ignores the
	  GPU's bandwidth demand: memory stays at its idle floor.

config APPLE_DISPLAY_GATE_KUNIT_TEST
	bool "KUnit tests for the Apple display gate" if !KUNIT_ALL_TESTS
	depends on KUNIT=y && APPLE_T6030_DISPLAY_GATE
	default KUNIT_ALL_TESTS
	help
	  Runs the display gate on test device trees with the T6030, T6031
	  and T8122 display nodes, without Apple hardware. On T6031: on by
	  default only on the default board (the J516C), otherwise only with
	  apple_t6031_display.enable=1, off with apple_t6031_display.enable=0,
	  only with the boot loader's handoff marker and this Mac's PMP values,
	  and with nothing changed when a check fails. On T6030: on by default, as
	  before, whatever the T6031 option says. On T8122: on by default,
	  and nothing changed when the handoff or the device tree's own PMP
	  topology does not check out.

endmenu

endif
```
