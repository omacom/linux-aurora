## arch/arm64/Kconfig.debug
```kconfig
# SPDX-License-Identifier: GPL-2.0-only

config PID_IN_CONTEXTIDR
	bool "Write the current PID to the CONTEXTIDR register"
	help
	  Enabling this option causes the kernel to write the current PID to
	  the CONTEXTIDR register, at the expense of some additional
	  instructions during context switch. Say Y here only if you are
	  planning to use hardware trace tools with this kernel.

config DEBUG_EFI
	depends on EFI && DEBUG_INFO
	bool "UEFI debugging"
	help
	  Enable this option to include EFI specific debugging features into
	  the kernel that are only useful when using a debug build of the
	  UEFI firmware

config ARM64_RELOC_TEST
	depends on m
	tristate "Relocation testing module"

source "drivers/hwtracing/coresight/Kconfig"

config ARM64_USER4K_EXPERIMENTAL
	bool "Experimental mixed-granule userspace"
	select ARCH_HAS_MM_PGTABLE
	select ARCH_HAS_USER_PAGE_SIZE
	select MM_SUBPAGE
	select MM_ID
	select HAVE_ARCH_TLB_REMOVE_TABLE
	select ARCH_SUPPORTS_PT_RECLAIM
	depends on (ARM64_16K_PAGES || ARM64_64K_PAGES) && ARM64_VA_BITS_48 && ARM64_PA_BITS_48
	depends on !ARM64_LPA2 && !NO_PAGE_MAPCOUNT
	default y
	help
	  Build the in-development MM support for alternative 4K user tables
	  on 16K/64K kernels and 16K user tables on 64K kernels.

	  This is experimental. The feature is on at run time unless the
	  kernel is booted with user4k=off. While it is off, the page-size
	  prctls refuse every non-native size with EINVAL, every exec gets
	  the native granule, the CPUs report no alternative
	  user granule and the per-page 4K ownership record in page_ext is not
	  reserved. The shared MM code paths remain compiled in either way.

	  While it is on, an experimental prctl selects a supported granule
	  for the next exec. Ordinary address spaces and kernel tables retain
	  the native granule. This is a development ABI: several MM interfaces
	  and device mappings still require integration and validation. The
	  private prctl numbers are not upstream assignments or a stable ABI
	  promise. Programs that do not use the prctl keep the native granule.

config ARM64_CPUINFO_KUNIT_TEST
	bool "KUnit tests for the /proc/cpuinfo model name" if !KUNIT_ALL_TESTS
	depends on KUNIT=y && DMI
	default KUNIT_ALL_TESTS
	help
	  Test how /proc/cpuinfo reads the processor's name from the SMBIOS
	  Processor Information.

config ARM64_USER4K_KUNIT_TEST
	bool "Test mixed userspace granules with larger kernel pages"
	depends on KUNIT=y && ARM64_USER4K_EXPERIMENTAL
	depends on ARM64_PA_BITS_48
	depends on TMPFS
	select ARM64_USER4K_DATA_KUNIT_TEST
	select IOMMUFD
	select IOMMUFD_DRIVER
	default n
	help
	  Exercise independent TTBR0 translation granules, subpage permissions
	  and invalidation while TTBR1 retains the normal native kernel tables.
	  Do not boot the test kernel with user4k=off; only the
	  arm64-user4k-policy suite is meant to run with it. Hardware
	  translation/uaccess fixtures also require arm64.user4k_test=1 and
	  are disabled with KASAN. Software MM
	  fixtures can run with KASAN without borrowing or replacing TTBR0.
	  Run only in a disposable test VM. This regression harness does not
	  establish hardware qualification or production ABI readiness.
	  Say N for normal kernels.

config ARM64_USER4K_IOMMUFD_TEST
	bool "IOMMUFD ioctl harness for mixed userspace granules"
	depends on ARM64_USER4K_EXPERIMENTAL && DEBUG_KERNEL
	depends on FAULT_INJECTION && RUNTIME_TESTING_MENU
	depends on IOMMU_SUPPORT
	select GENERIC_PT
	select IOMMU_PT
	select IOMMU_PT_AMDV1
	select IOMMUFD
	select IOMMUFD_TEST
	default n
	help
	  Enable the IOMMUFD mock-device ioctls and generic AMDv1 page tables
	  for the mixed-granule userspace ioctl fixture. This exposes privileged
	  test interfaces; use only in a disposable test VM.
	  Say N for normal kernels.

config ARM64_USER4K_VFIO_ACCOUNT_TEST
	bool "VFIO type1 pinning harness for mixed userspace granules"
	depends on ARM64_USER4K_EXPERIMENTAL && KUNIT=y
	depends on IOMMUFD != m
	depends on TMPFS
	select VFIO
	select VFIO_GROUP
	select VFIO_CONTAINER
	select VFIO_IOMMU_TYPE1
	select VFIO_TYPE1_ACCOUNT_KUNIT_TEST
	default n
	help
	  Enable built-in VFIO type1 accounting and retained-fragment tests
	  in a disposable mixed-granule guest. Recorded IOMMU translations
	  do not establish physical-device DMA support.
	  Say N for normal kernels.

config ARM64_USER4K_VFIO_IOCTL_TEST
	bool "Private VFIO type1 ioctl harness for mixed userspace granules"
	depends on ARM64_USER4K_EXPERIMENTAL && KUNIT=y && DEBUG_KERNEL
	depends on RUNTIME_TESTING_MENU
	depends on IOMMUFD != m
	depends on TMPFS
	select ARM64_USER4K_VFIO_ACCOUNT_TEST
	default n
	help
	  Expose a root-only disposable-guest misc device forwarding real EL0
	  arguments to type1 ioctls and supplying recording IOMMU domains.
	  These privileged test controls perform no physical device DMA.
	  Say N for normal kernels.

config ARM64_USER4K_DATA_KUNIT_TEST
	bool "Test packed userspace allocation ownership"
	depends on KUNIT=y && ARM64_USER4K_EXPERIMENTAL
	default n
	help
	  Exercise packed allocation, slot reuse, copying and deferred lifetime.
	  These tests use native kernel addresses without changing TTBR0, and
	  can run with KASAN even when the architectural tests are disabled.
	  Do not boot the test kernel with user4k=off.
```

## drivers/gpu/drm/apple/Kconfig
```kconfig
# SPDX-License-Identifier: GPL-2.0-only OR MIT
config DRM_APPLE
	tristate "DRM Support for Apple display controllers"
	depends on DRM && OF && ARM64
	depends on ARCH_APPLE || COMPILE_TEST
	depends on APPLE_RTKIT
	depends on TYPEC || !TYPEC
	depends on OF_ADDRESS
	# The firmware-27 remote buffer path calls into the DART driver.
	depends on APPLE_DART || !APPLE_DART
	select APPLE_PMP_REPORT
	select OF_DYNAMIC
	select DRM_CLIENT_SELECTION
	select DRM_KMS_HELPER
	select DRM_KMS_DMA_HELPER
	select DRM_GEM_SHMEM_HELPER
	select DRM_GEM_DMA_HELPER
	select VIDEOMODE_HELPERS
	# write-combined maps of firmware-placed carveouts (desktop 26.x)
	select VMAP_PFN
	depends on BACKLIGHT_CLASS_DEVICE
	select MULTIPLEXER
	select DRM_APPLE_FABRIC_CORE
	select CEC_CORE if DRM_APPLE_CEC
	help
	  Say Y if you have an Apple Silicon chipset. This includes the
	  Type-C display fabric and Thunderbolt display routing.

config DRM_APPLE_CEC
	bool "HDMI CEC support"
	default y
	depends on DRM_APPLE
	help
	  Enable HDMI Consumer Electronics Control (CEC) support on Apple
	  Silicon machines with a built-in HDMI port via the compact EPIC
	  dcpav-cec-interface-epic service. Say Y here to expose a standard
	  Linux /dev/cecX adapter bound to the built-in HDMI connector.

config DRM_APPLE_AUDIO
	bool "DisplayPort/HDMI Audio support"
	default y
	depends on DRM_APPLE
	depends on SND=y || SND=DRM_APPLE
	select SND_PCM
	select SND_DMAENGINE_PCM

config DRM_APPLE_DCP_T6030_AUDIO
	bool "Native audio links through external display processors"
	default y
	depends on DRM_APPLE_AUDIO
	help
	  DP/HDMI audio of the external display processors of the M3 Pro
	  (T6030, MacBook Pro J514S/J516S built-in HDMI port), whose DCP
	  firmware 14.7 external role takes 32-byte audio link data and the
	  native driver's link lifecycle. Also build the compact audio service
	  binding for desktop 26.x external processors (T6041). Those audio
	  interfaces remain disabled until SIO firmware support is available.
	  Say N to omit native links and the desktop compact audio binding.

config DRM_APPLE_DCP_T8132
	bool "MacBook Air M4 (J713) internal panel"
	depends on DRM_APPLE
	depends on APPLE_DART=y && APPLE_DART_J713_DCP
	depends on APPLE_PMP=y || APPLE_PMP=DRM_APPLE
	select APERTURE_HELPERS
	help
	  Lets the common Apple display driver adopt the J713 (T8132)
	  internal display coprocessor and its display subsystem. The
	  inherited firmware session uses the IOMFB 26.6 interface, while
	  planes, CRTCs, connectors and DMA GEM use the common DRM driver.

	  The boot loader must publish the qualified firmware reservations
	  and inherited display DART mappings. The retained session cannot
	  be unloaded or reset; its backing stays pinned until reboot.
	  Load appledrm explicitly before the GPU, with its alias autoload
	  disabled, after guarded admission of the inherited display DARTs.

config DRM_APPLE_DEBUG
	bool "Enable additional driver debugging"
	depends on DRM_APPLE
	depends on EXPERT # only for developers

config DRM_APPLE_KUNIT_TEST
	tristate "KUnit tests for Apple display controller" if !KUNIT_ALL_TESTS
	depends on KUNIT
	depends on DRM_APPLE || !DRM_APPLE
	select DRM_KUNIT_TEST_HELPERS if DRM_APPLE
	default KUNIT_ALL_TESTS
	help
	  Build tests for the Apple display driver's AFK ring parser and
	  backlight policy (takeover, DPMS, suspend, fades and present
	  completion).
	  The tests cover the header strides used by older firmware and
	  larger rings, as well as malformed ring size combinations.
	  This option is intended for developer test kernels.
	  Also test the Type-C modeset, hotplug and service ownership state,
	  the system resume of a CRTC whose mode is no longer admissible,
	  when an external display is ready to be reported to userspace, and
	  which display processors must have started before the boot
	  framebuffer is taken over.
	  The AFK service lifetime test uses the display driver and is built
	  with it. When the driver is a module, these tests can only be
	  built as modules too. The standalone modeset state test can still
	  be built without the driver.

config DRM_APPLE_PARSER_KUNIT_TEST
	bool "KUnit tests for Apple firmware message parsers" if !KUNIT_ALL_TESTS
	depends on DRM_APPLE && KUNIT=y
	default KUNIT_ALL_TESTS
	help
	  Build tests for AFKv2 lengths, DMA ownership and reply correlation,
	  legacy EPIC replies, and H17P IOMFB callback envelopes and sizes.
	  The tests use allocated buffers and fake devices and do not require
	  an Apple display controller or any firmware.

config DRM_APPLE_DISPLAY_KUNIT_TEST
	bool "KUnit tests for Apple display mode probing" if !KUNIT_ALL_TESTS
	depends on KUNIT && DRM_APPLE
	select DRM_KUNIT_TEST_HELPERS
	select DRM_CLIENT
	default KUNIT_ALL_TESTS
	help
	  Test the production timing parser and display reply bounds without
	  Apple display hardware, including incomplete records and stable
	  preferred mode selection. Exercise mode list replacement and
	  catalog admission for each display attachment. Check connector
	  status updates before hotplug notifications and same-state retrains.
	  Check which 14.x board record an internal display gets on which
	  machine, and which DCP firmware image each record admits.
```

## drivers/media/platform/apple/ave/Kconfig
```kconfig
# SPDX-License-Identifier: GPL-2.0-only

config VIDEO_APPLE_AVE
	tristate "Apple AVE video encoder"
	depends on ARCH_APPLE || COMPILE_TEST
	depends on VIDEO_DEV && IOMMU_DMA && PM_GENERIC_DOMAINS
	select CRC32
	select V4L2_MEM2MEM_DEV
	select VIDEOBUF2_DMA_CONTIG
	help
	  V4L2 memory-to-memory driver for the AVE H.264/HEVC encoder in
	  Apple T8140 (A18 Pro) SoCs, as in the MacBook Neo.
	  T6000 (M1 Pro) and T8112 (M2) support lifecycle-only validation
	  of firmware 6070.11.1 through debugfs; encoding stays disabled.
	  T8122 (M3) with the macOS 27.2 firmware encodes H.264 and HEVC.
	  T6041 (M4 Pro) and the M3 Pro/Max (T603x) have probe-only
	  support. T6050 (M5 Pro/Max) encodes H.264.

	  The encoder firmware is loaded by the bootloader; the driver builds
	  every command itself. See Documentation/admin-guide/media/apple-ave.rst.

	  To compile this driver as a module, choose M here: the module
	  will be called apple-ave.

config VIDEO_APPLE_AVE_KUNIT_TEST
	tristate "KUnit tests for Apple AVE buffer sizing and recovery" if !KUNIT_ALL_TESTS
	depends on KUNIT
	default KUNIT_ALL_TESTS
	help
	  Test the exact LFS reference descriptor sizes for pre-M4 and T8140
	  encoders, including picture alignment boundaries and the reference
	  1920x1080 AVC and HEVC sizes. The tests do not need an encoder or
	  any firmware and can run independently of the AVE driver.
	  Also test the firmware recovery sliding window and jiffies wrap.

config VIDEO_APPLE_AVE_CMD_KUNIT_TEST
	bool "KUnit tests for Apple AVE firmware ABIs" if !KUNIT_ALL_TESTS
	depends on KUNIT && VIDEO_APPLE_AVE=y
	default KUNIT_ALL_TESTS
	help
	  Compare AVC/HEVC 9003 Start and Process images byte for byte with
	  the pre-refactor builder. Test 6070 lifecycle envelopes, replies,
	  1080p/4K Start and Process fields, fixed and split surface banks,
	  entropy interleave, alignment refusal, seven-channel discovery and
	  encoding refusal.
	  These tests run without firmware or encoder hardware.
```

## drivers/media/platform/apple/prores/Kconfig
```kconfig
# SPDX-License-Identifier: GPL-2.0-only

config VIDEO_APPLE_PRORES
	tristate "Apple Silicon ProRes encoder"
	depends on VIDEO_DEV
	depends on ARCH_APPLE || (COMPILE_TEST && 64BIT)
	depends on OF && IOMMU_API && PM
	select V4L2_MEM2MEM_DEV
	select VIDEOBUF2_DMA_CONTIG
	help
	  V4L2 memory-to-memory driver for the ProRes encoder engine (APR)
	  in Apple M1 Pro (T6000), M4 (T8132), M4 Pro (T6041), M5 (T8142),
	  M5 Pro/Max (T6050) and A18 Pro (T8140) SoCs. On T6041, T8142 and
	  T6050 a per-machine apple/prores-<soc>-init.bin takes the place of
	  the built-in initialization rows; T8132 has no built-in rows and
	  binds only with apple/prores-t8132-init.bin. It encodes 8
	  and 16 bit 4:2:2 and 4:4:4 frames to ProRes 422 Proxy, LT, 422, HQ,
	  4444 and 4444 XQ.

	  To compile this driver as a module, choose M here: the module
	  will be called apple-prores.

config VIDEO_APPLE_PRORES_KUNIT_TEST
	tristate "KUnit tests for the Apple ProRes encoder" if !KUNIT_ALL_TESTS
	depends on KUNIT && VIDEO_APPLE_PRORES
	default KUNIT_ALL_TESTS
	help
	  Check the APRI firmware parser, quantisation tables, DC scale table,
	  and job descriptors. APRI fixtures are wholly synthetic and contain
	  no vendor initialization values. The parser cases cover the complete
	  container shape and every row constraint. No hardware is needed.
```
