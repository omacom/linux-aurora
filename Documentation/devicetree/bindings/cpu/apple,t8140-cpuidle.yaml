## Documentation/devicetree/bindings/sound/apple,macaudio.yaml
```yaml
# SPDX-License-Identifier: (GPL-2.0-only OR BSD-2-Clause)
%YAML 1.2
---
$id: http://devicetree.org/schemas/sound/apple,macaudio.yaml#
$schema: http://devicetree.org/meta-schemas/core.yaml#

title: Apple Silicon Macs integrated sound peripherals

description:
  This binding represents the overall machine-level integration of sound
  peripherals on 'Apple Silicon' machines by Apple.

maintainers:
  - Martin Povišer <povik+lin@cutebit.org>

properties:
  compatible:
    oneOf:
      - items:
          - enum:
              - apple,j180-macaudio
              - apple,j274-macaudio
              - apple,j293-macaudio
              - apple,j313-macaudio
              - apple,j314-macaudio
              - apple,j316-macaudio
              - apple,j375-macaudio
              - apple,j413-macaudio
              - apple,j415-macaudio
              - apple,j433-macaudio
              - apple,j434-macaudio
              - apple,j456-macaudio
              - apple,j457-macaudio
              - apple,j473-macaudio
              - apple,j493-macaudio
              - apple,j575c-macaudio
              - apple,j775c-macaudio
              - apple,j775d-macaudio
              - apple,j575c-macaudio-jack
              - apple,j604-macaudio
              - apple,j604-macaudio-jack
              - apple,j614-macaudio
              - apple,j614-macaudio-jack
              - apple,j616-macaudio
              - apple,j616-macaudio-jack
              - apple,j623-macaudio-jack
              - apple,j624-macaudio-jack
              - apple,j700-macaudio
              - apple,j713-macaudio
              - apple,j713-macaudio-jack
              - apple,j714-macaudio
              - apple,j715-macaudio
              - apple,j715-macaudio-jack
              - apple,j773-macaudio
              - apple,j773-macaudio-jack
              - apple,j813-macaudio
              - apple,j815-macaudio
              - apple,j873-macaudio
              - apple,k116-macaudio
          - const: apple,macaudio
      - description:
          Machines that share the speaker and jack layout of an earlier
          machine list that machine as a fallback.
        items:
          - enum:
              - apple,j414-macaudio
              - apple,j416-macaudio
              - apple,j474-macaudio
              - apple,j475-macaudio
              - apple,j504-macaudio
              - apple,j514-macaudio
              - apple,j516-macaudio
              - apple,j575-macaudio
              - apple,j613-macaudio
              - apple,j615-macaudio
          - enum:
              - apple,j314-macaudio
              - apple,j316-macaudio
              - apple,j375-macaudio
              - apple,j413-macaudio
              - apple,j415-macaudio
              - apple,j473-macaudio
          - const: apple,macaudio

  "#address-cells":
    const: 1

  "#size-cells":
    const: 0

  model:
    description:
      Model name for presentation to users
    $ref: /schemas/types.yaml#/definitions/string

  speaker-id-gpios:
    minItems: 1
    maxItems: 8
    description:
      Inputs encoding the fitted speaker assembly variant, least significant
      bit first. The machine driver exposes their logical levels through the
      read-only Speaker Variant ID control. GPIO polarity flags define each
      bit's logical level.

patternProperties:
  "^dai-link(@[0-9a-f]+)?$":
    description: |
      Node for each sound peripheral such as the speaker array, headphones jack,
      or microphone.
    type: object

    additionalProperties: false

    properties:
      reg:
        maxItems: 1

      link-name:
        description: |
          Name for the peripheral, expecting 'Speaker' or 'Speakers' if this is
          the speaker array.
        $ref: /schemas/types.yaml#/definitions/string

      cpu:
        type: object

        properties:
          sound-dai:
            description: |
              DAI list with CPU-side I2S ports involved in this peripheral.
            minItems: 1
            maxItems: 2

        required:
          - sound-dai

      codec:
        type: object

        properties:
          sound-dai:
            minItems: 1
            maxItems: 8
            description: |
              DAI list with the CODEC-side DAIs connected to the above CPU-side
              DAIs and involved in this sound peripheral.

              The list is in left/right order if applicable. If there are more
              than one CPU-side DAIs (there can be two), the CODECs must be
              listed first those connected to the first CPU, then those
              connected to the second.

              In addition, on some machines with many speaker codecs, the CODECs
              are listed in this fixed order:

              J293: Left Front, Left Rear, Right Front, Right Rear
              J314: Left Woofer 1, Left Tweeter, Left Woofer 2,
                    Right Woofer 1, Right Tweeter, Right Woofer 2

        required:
          - sound-dai

    patternProperties:
      "^dai-tdm-idle-mode-[0-7]$":
        description: |
          How the CODEC at this index of the codec sound-dai list drives the
          TDM transmit slots it leaves idle. The index counts the CODECs of
          the link in list order, across both CPU-side DAIs.
        $ref: /schemas/types.yaml#/definitions/string
        enum:
          - zero
          - pulldown

      "^dai-tdm-slot-tx-idle-mask-[0-7]$":
        description: |
          Transmit slots of the CODEC at the same index that are idle and
          driven as dai-tdm-idle-mode-<n> says, one bit per slot with slot 0
          in the LSB. Only used together with dai-tdm-idle-mode-<n>.
        $ref: /schemas/types.yaml#/definitions/uint32

    required:
      - reg
      - cpu
      - codec

required:
  - compatible
  - model

additionalProperties: false

examples:
  - |
    mca: mca@9b600000 {
      compatible = "apple,t6000-mca", "apple,mca";
      reg = <0x9b600000 0x10000>,
            <0x9b500000 0x20000>;

      clocks = <&nco 0>, <&nco 1>, <&nco 2>, <&nco 3>;
      power-domains = <&ps_audio_p>, <&ps_mca0>, <&ps_mca1>,
                      <&ps_mca2>, <&ps_mca3>;
      dmas = <&admac 0>, <&admac 1>, <&admac 2>, <&admac 3>,
             <&admac 4>, <&admac 5>, <&admac 6>, <&admac 7>,
             <&admac 8>, <&admac 9>, <&admac 10>, <&admac 11>,
             <&admac 12>, <&admac 13>, <&admac 14>, <&admac 15>;
      dma-names = "tx0a", "rx0a", "tx0b", "rx0b",
                  "tx1a", "rx1a", "tx1b", "rx1b",
                  "tx2a", "rx2a", "tx2b", "rx2b",
                  "tx3a", "rx3a", "tx3b", "rx3b";

      #sound-dai-cells = <1>;
    };

    sound {
      compatible = "apple,j314-macaudio", "apple,macaudio";
      model = "MacBook Pro J314 integrated audio";

      #address-cells = <1>;
      #size-cells = <0>;

      dai-link@0 {
        reg = <0>;
        link-name = "Speakers";

        cpu {
          sound-dai = <&mca 0>, <&mca 1>;
        };
        codec {
          sound-dai = <&speaker_left_woof1>,
                      <&speaker_left_tweet>,
                      <&speaker_left_woof2>,
                      <&speaker_right_woof1>,
                      <&speaker_right_tweet>,
                      <&speaker_right_woof2>;
        };
      };

      dai-link@1 {
        reg = <1>;
        link-name = "Headphones Jack";

        cpu {
          sound-dai = <&mca 2>;
        };
        codec {
          sound-dai = <&jack_codec>;
        };
      };
    };
```

## Documentation/devicetree/bindings/usb/apple,sn201202x.yaml
```yaml
# SPDX-License-Identifier: (GPL-2.0-only OR BSD-2-Clause)
%YAML 1.2
---
$id: http://devicetree.org/schemas/usb/apple,sn201202x.yaml#
$schema: http://devicetree.org/meta-schemas/core.yaml#

title: Texas Instruments sn201202x Type-C Power Delivery controller

maintainers:
  - Sasha Finkelstein <k@chaosmail.tech>

description: |
  Texas Instruments sn201202x Type-C Power Delivery controller

  A variant of tps6598x controller also known as Apple ACE3
  present on hardware with Apple SoCs starting from the M3.

  The controller can be polled when interrupt resources are not supplied.

  T8132 omits the register-selection interrupt, so selection is polled while
  event, standby and wakeup notifications use interrupts.

properties:
  compatible:
    oneOf:
      - const: apple,sn201202x
      - items:
          - const: apple,t8132-sn201202x
          - const: apple,sn201202x

  reg:
    maxItems: 1

  interrupts:
    minItems: 3
    maxItems: 4

  interrupt-names:
    minItems: 3
    maxItems: 4

  wakeup-source: true

  apple,sleep-ssps:
    type: boolean
    description:
      Tell the controller the system's power state (SSPS) around a
      firmware-driven suspend, S3 before it and S0 after.

  apple,cable-change-ssps:
    type: boolean
    description:
      At a cable change while running, send the controller the system power
      state sequence macOS sends it (traced on the J714s). At a detach, write
      register 0x50, then SSPS 0x02. At an attach, SSPS 0x00, then USBw 0x00
      after the attach's debounce.

  apple,sleep-ssps-rules:
    type: boolean
    description:
      Talk to the controller under the sleep's rules. For its system power
      state command, wake it on its bus first and read the command's end at
      intervals rather than back to back. For every command, count one found
      done on a read made past its limit as done. A controller that does not
      take S3 refuses the sleep. The controllers that need these rules are
      polled on their bus and miss or delay a command's end when read back to
      back.

  apple,reset-on-failed-probe:
    type: boolean
    description:
      The previous boot can leave the controller in the middle of a command,
      so its first probe can fail on the reads that follow. Probe it again a
      few times after waits, with a cold reset before a late try, before
      deferring the probe.

  apple,debug-lock-key:
    $ref: /schemas/types.yaml#/definitions/string
    pattern: "^.{4}$"
    description:
      The four-character key (the board number, reversed, such as "417J" on
      the J714s) that the controller's LOCK command takes to unlock the
      commands that need it. These are its debug mode, for rearming the
      debug link after a sleep ended it, and a disconnect and reattach of
      its partner (DISC).

  apple,event-irq-in-sleep:
    type: boolean
    description:
      The controller's event interrupt stays live while the controller
      sleeps, so it can sleep while its port is idle and still report a
      port event. A register access wakes it first.

  apple,usb-remote-wake:
    type: boolean
    description:
      This controller serves the USB controller's root port, and watches its
      USB2 lines for a remote wakeup during a firmware-driven system sleep.

  connector:
    $ref: /schemas/connector/usb-connector.yaml#

  apple,no-liquid-detection:
    type: boolean
    description:
      The controller's port has no liquid detection and corrosion mitigation
      (LDCM), as on the MagSafe 3 port, which the ADT lists with the
      "Power In" feature only.

  apple,reset-inherited-usb2-connection:
    type: boolean
    description: |
      A connection that is up when the OS starts keeps state from the boot
      chain that resetting the host PHY does not recover: a USB2 repeater
      connection on the boot port (J716c), or a Type-C retimer set up before
      the host PHY ran, which keeps SuperSpeed from training (J575c).
      Renegotiate a normal application connection before starting the host
      controllers. Debug routes are preserved.

required:
  - compatible
  - reg

allOf:
  - if:
      properties:
        compatible:
          contains:
            const: apple,t8132-sn201202x
    then:
      properties:
        interrupts:
          items:
            - description: Primary irq used for tps6598x events
            - description: Standby command completed
            - description: Wakeup command completed
        interrupt-names:
          items:
            - const: irq
            - const: sleep
            - const: wake
    else:
      properties:
        interrupts:
          items:
            - description: Primary irq used for tps6598x events
            - description: Logical register selection completed
            - description: Standby command completed
            - description: Wakeup command completed
        interrupt-names:
          items:
            - const: irq
            - const: select
            - const: sleep
            - const: wake

dependentRequired:
  interrupts: [interrupt-names]
  interrupt-names: [interrupts]

additionalProperties: false

examples:
  - |
    #include <dt-bindings/interrupt-controller/irq.h>
    #include <dt-bindings/spmi/spmi.h>
    spmi {
        #address-cells = <2>;
        #size-cells = <0>;
        usb-pd@c {
            compatible = "apple,sn201202x";
            reg = <0xc SPMI_USID>;
            interrupts = <11 IRQ_TYPE_EDGE_RISING>,
                         <13 IRQ_TYPE_EDGE_RISING>,
                         <17 IRQ_TYPE_EDGE_RISING>,
                         <19 IRQ_TYPE_EDGE_RISING>;
            interrupt-names = "irq", "select", "sleep", "wake";

            connector {
                compatible = "usb-c-connector";
                label = "USB-C";

                port {
                    typec_ep: endpoint {
                        remote-endpoint = <&otg_ep>;
                    };
                };
            };
        };
    };
```
