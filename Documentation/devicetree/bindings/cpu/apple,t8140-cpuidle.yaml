## Documentation/devicetree/bindings/soc/apple/apple,pmp.yaml
```yaml
# SPDX-License-Identifier: (GPL-2.0-only OR BSD-2-Clause)
%YAML 1.2
---
$id: http://devicetree.org/schemas/soc/apple/apple,pmp.yaml#
$schema: http://devicetree.org/meta-schemas/core.yaml#

title: Apple power management co-processor

maintainers:
  - Ryan Murray <ryan@aurorasilicon.org>

description: |
  The PMP runs firmware loaded by the bootloader. Linux starts it through
  RTKit and supplies calibration copied from the Apple device tree. The
  bootloader must initialize the PMP DART address protection filter before
  Linux starts the firmware. Firmware-owned PMC power state must be retained.

properties:
  compatible:
    oneOf:
      - items:
          - const: apple,t6020-pmp-v2
          - const: apple,t6000-pmp-v2
      - const: apple,t6000-pmp-v2
      - items:
          - enum:
              - apple,t6030-pmp-v2
              - apple,t6031-pmp-v2
              - apple,t6034-pmp-v2
              - apple,t6041-pmp-v2
              - apple,t6050-pmp-v2
              - apple,t8122-pmp-v2
              - apple,t8132-pmp-v2
              - apple,t8140-pmp-v2
          - const: apple,t6000-pmp-v2
      - items:
          - const: apple,t8142-pmp-v2
          - const: apple,t8140-pmp-v2
      - items:
          - const: apple,t8103-pmp
          - const: apple,pmp

  reg:
    minItems: 2
    maxItems: 37
    description:
      Coprocessor and peripheral register views. First-generation firmware
      views include shared apertures; a driver must coordinate ownership
      rather than claim every view as an exclusive resource.

  reg-names:
    items:
      - const: pmp
      - const: asc

  mboxes:
    maxItems: 1

  mbox-names:
    const: mbox

  interrupts:
    maxItems: 4
    description: Coprocessor mailbox and status interrupts.

  iommus:
    maxItems: 1

  power-domains:
    minItems: 1
    maxItems: 2

  apple,pmp-report:
    $ref: /schemas/types.yaml#/definitions/phandle
    description: Report provider whose running state qualifies device-power requests.

  apple,board-id:
    $ref: /schemas/types.yaml#/definitions/uint32
    description: Board identifier copied by the bootloader.

  apple,dram-vendor-id:
    $ref: /schemas/types.yaml#/definitions/uint32
    description: DRAM vendor identifier copied by the bootloader.

  apple,dram-capacity:
    $ref: /schemas/types.yaml#/definitions/uint32
    description: Firmware DRAM capacity value copied by the bootloader.

  apple,dram-channel-disable:
    $ref: /schemas/types.yaml#/definitions/uint32
    description: Disabled DRAM channel mask (boot argument DCHD), copied by the bootloader.

  apple,pmc:
    $ref: /schemas/types.yaml#/definitions/uint32
    description: Boot argument PMC_, the PMGR's pmc value in the Apple device tree.

  apple,pmc-pmgr:
    $ref: /schemas/types.yaml#/definitions/uint32
    description:
      PMGR PMC configuration word from the Apple device tree. Bits 0 and 3
      are passed as the boot arguments PMCV and PMCB.

  status: true

  apple,pmc-msg-disabled:
    $ref: /schemas/types.yaml#/definitions/uint32
    description: Boot argument PMCX, from the Apple device tree.

  apple,soc-chip-variant:
    $ref: /schemas/types.yaml#/definitions/uint32
    description: SoC chip variant (boot argument CVAR), copied by the bootloader.

  apple,pio-ranges:
    $ref: /schemas/types.yaml#/definitions/uint64-array
    minItems: 2
    description: Host physical address and size pairs mapped into firmware PIO space.

  apple,sram-keep:
    $ref: /schemas/types.yaml#/definitions/uint32-array
    items:
      - description: Offset in the firmware SRAM
      - description: Size
    description:
      The firmware SRAM range the OS keeps over a system sleep, read after the
      firmware's stop and written back before its restart. Set by the bootloader.

  apple,tunable-segment-names:
    $ref: /schemas/types.yaml#/definitions/string
    description:
      The firmware's segment names from the Apple device tree, separated by
      semicolons. The firmware reads them as the raw string.

patternProperties:
  '^apple,tunable-(?!segment-names$)':
    $ref: /schemas/types.yaml#/definitions/uint8-array
    description: Opaque firmware calibration copied from the Apple device tree.

required:
  - compatible
  - reg
  - iommus

allOf:
  - if:
      properties:
        compatible:
          contains:
            const: apple,t8103-pmp
    then:
      properties:
        reg:
          minItems: 37
        power-domains:
          minItems: 2
      required:
        - power-domains
        - mboxes
        - mbox-names
    else:
      if:
        properties:
          compatible:
            contains:
              const: apple,t6050-pmp-v2
      then:
        description:
          The T6050 PMP's firmware SRAM and ASC views and its ASC mailbox. It
          also holds the PMS SRAM's power domain.
        properties:
          reg:
            maxItems: 2
          power-domains:
            minItems: 2
          interrupts: false
        required:
          - reg-names
          - mboxes
          - mbox-names
          - power-domains
      else:
        properties:
          reg:
            maxItems: 2
          power-domains:
            maxItems: 1
          interrupts: false
        required:
          - reg-names
          - mboxes
          - mbox-names

additionalProperties: false

examples:
  - |
    soc {
        #address-cells = <2>;
        #size-cells = <2>;

        pmp@300500000 {
            compatible = "apple,t8140-pmp-v2", "apple,t6000-pmp-v2";
            reg = <3 0x00500000 0 0xa0000>, <3 0x00e00000 0 0x4000>;
            reg-names = "pmp", "asc";
            mboxes = <&pmp_mbox>;
            mbox-names = "mbox";
            iommus = <&pmp_dart 0>;
        };
    };
```

## Documentation/devicetree/bindings/soc/apple/apple,rtk-helper-asc4.yaml
```yaml
# SPDX-License-Identifier: (GPL-2.0-only OR BSD-2-Clause)
%YAML 1.2
---
$id: http://devicetree.org/schemas/soc/apple/apple,rtk-helper-asc4.yaml#
$schema: http://devicetree.org/meta-schemas/core.yaml#

title: Apple ASC4 RTKit helper coprocessor

maintainers:
  - Ryan Murray <ryan@aurorasilicon.org>

description:
  Apple SoCs contain a number of ASC coprocessors that run RTKit firmware.
  For some of them the operating system only has to boot the coprocessor and
  keep it running, while the devices it serves are described by other nodes.
  The MTP (multi-touch processor) ASC of Apple laptops is one of these. It
  serves the built-in keyboard and trackpad over DockChannel, and the
  DockChannel HID transport refers to this node through its apple,helper-cpu
  property.

properties:
  compatible:
    items:
      - enum:
          - apple,t6020-mtp
          - apple,t6030-mtp
          - apple,t6031-mtp
          - apple,t6041-mtp
          - apple,t6050-mtp
          - apple,t8112-mtp
          - apple,t8122-mtp
          - apple,t8132-mtp
          - apple,t8140-mtp
          - apple,t8142-mtp
      - enum:
          - apple,t6020-rtk-helper-asc4
          - apple,t6030-rtk-helper-asc4
          - apple,t6041-rtk-helper-asc4
          - apple,t6050-rtk-helper-asc4
          - apple,t8112-rtk-helper-asc4
          - apple,t8122-rtk-helper-asc4
          - apple,t8132-rtk-helper-asc4
          - apple,t8140-rtk-helper-asc4
          - apple,t8142-rtk-helper-asc4
      - const: apple,mtp
      - const: apple,rtk-helper-asc4

  reg:
    minItems: 1
    items:
      - description: ASC control registers
      - description:
          Coprocessor SRAM, from which the firmware may ask the host to map
          buffers instead of allocating them from system memory

  reg-names:
    minItems: 1
    items:
      - const: asc
      - const: sram

  mboxes:
    maxItems: 1

  iommus:
    minItems: 1
    maxItems: 2

  apple,rtkit-handoff:
    enum:
      - mtp-live-v1
    description: |
      The producer reserves firmware-visible buffers and retains their DART
      mappings, and transfers a running RTKit session without renegotiation.
      On T8132 it also supplies apple,rtkit-buffers, leaves the initial
      DockChannel HID header unread, and retains the helper's identity DART
      bypass. The host continues servicing system endpoints without restarting
      the coprocessor or taking it to QUIESCED.

  apple,rtkit-keep-running:
    type: boolean
    description: |
      The helper's firmware cannot be restarted once it has been taken to
      QUIESCED, so a boot stage that starts it hands its first RTKit epoch to
      the OS running, with apple,rtkit-handoff, instead of stopping it. Set by
      the board device tree for the firmware it describes. The OS does not
      read it.

  apple,rtkit-buffers:
    oneOf:
      - type: boolean
      - $ref: /schemas/types.yaml#/definitions/uint32-array
        minItems: 5
        maxItems: 20
    description: |
      An empty property records that no shared buffers were negotiated.
      Otherwise this is the inventory of every shared buffer negotiated,
      in groups of five cells: system endpoint number, device address high
      cell, device address low cell, exact protocol size in bytes, and the
      original request's is-mapped flag (0 or 1). Endpoint numbers are 1 for
      crashlog, 2 for syslog, 4 for IOReport, and 8 for OSLog, each at most once.
      The last cell records whether firmware supplied the original address;
      it does not classify the backing memory as SRAM or DRAM. Device
      addresses are physical addresses under the retained identity bypass.
      SRAM buffers must lie inside the sram register resource. Every DRAM
      buffer must lie inside a no-map reserved-memory region referenced by
      memory-region. The inventory is installed before mailbox RX is enabled;
      repeating an existing request cannot replace a live allocation.

  memory-region:
    minItems: 1
    maxItems: 4
    description:
      Reserved no-map DRAM buffers held by the running coprocessor. This
      excludes buffers inside its SRAM register resource.

  linux-enablement-mac,rtkit-inherited:
    deprecated: true
    description: |
      Legacy J713 preservation contract. An empty property or one 32-bit
      cell containing 1 retains the running helper. A cell containing 0
      selects ordinary startup. This carries no buffer inventory or verified
      reservation record; the consumer can service system notifications but
      cannot reconstruct or replace the existing shared buffers. New
      producers use mtp-live-v1 and may retain this marker for older kernels.
    oneOf:
      - type: boolean
      - $ref: /schemas/types.yaml#/definitions/uint32
        enum: [0, 1]

  '#helper-cells':
    const: 0
    description:
      Present in existing device trees. Nothing references the helper with
      argument cells; the DockChannel HID transport uses a plain phandle.

required:
  - compatible
  - reg
  - reg-names
  - mboxes
  - iommus

allOf:
  - if:
      properties:
        compatible:
          contains:
            const: apple,t8132-mtp
      required:
        - apple,rtkit-handoff
    then:
      required:
        - apple,rtkit-buffers

additionalProperties: false

examples:
  - |
    soc {
        #address-cells = <2>;
        #size-cells = <2>;

        mtp@314600000 {
            compatible = "apple,t8140-mtp", "apple,t8140-rtk-helper-asc4",
                         "apple,mtp", "apple,rtk-helper-asc4";
            reg = <0x3 0x14600000 0x0 0x4000>,
                  <0x3 0x14050000 0x0 0x4000>;
            reg-names = "asc", "sram";
            mboxes = <&mtp_mbox>;
            iommus = <&mtp_dart 0>;
        };
    };
```
