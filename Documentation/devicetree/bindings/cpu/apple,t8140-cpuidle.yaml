## Documentation/devicetree/bindings/power/apple,t8140-pmp-report.yaml
```yaml
# SPDX-License-Identifier: (GPL-2.0-only OR BSD-2-Clause)
%YAML 1.2
---
$id: http://devicetree.org/schemas/power/apple,t8140-pmp-report.yaml#
$schema: http://devicetree.org/meta-schemas/core.yaml#

title: Apple PMP report aperture

maintainers:
  - Ryan Murray <ryan@aurorasilicon.org>

description: |
  The PMP report aperture contains a read window and an update window.
  The PMP running bit qualifies the per-cluster fast-die effort. Lane 1
  tracks P-cluster load in Linux measurements. Lane 0 is assigned to the
  E cluster from the Apple device tree order and has not been observed
  changing. The T6041 report has three lanes: E, P0 and P1. Only
  documented report entries may be read; the aperture is not a
  contiguous readable array of registers.

allOf:
  - if:
      properties:
        compatible:
          const: apple,t6000-pmp-v2-report
    then:
      properties:
        reg:
          maxItems: 2
    else:
      properties:
        reg:
          maxItems: 1
        reg-names: false
  - if:
      properties:
        reg:
          minItems: 2
    then:
      required:
        - reg-names

  - $ref: apple,pmp-dram.yaml#

properties:
  compatible:
    oneOf:
      - enum:
          - apple,t6000-pmp-v2-report
          - apple,t6020-pmp-v2-report
          - apple,t6030-pmp-v2-report
          - apple,t6041-pmp-v2-report
          - apple,t6050-pmp-v2-report
          - apple,t8112-pmp-v2-report
          - apple,t8122-pmp-v2-report
          - apple,t8140-pmp-v2-report
      - items:
          - enum:
              - apple,t6031-pmp-v2-report
              - apple,t6034-pmp-v2-report
          - const: apple,t6020-pmp-v2-report

  reg:
    minItems: 1
    maxItems: 2

  reg-names:
    items:
      - const: report
      - const: ane-dvfs

  nonposted-mmio: true

  power-domains:
    maxItems: 1

  '#address-cells':
    const: 1

  '#size-cells':
    const: 0

  apple,ptd-boot:
    $ref: /schemas/types.yaml#/definitions/uint64-matrix
    items:
      items:
        - description:
            The entry to write, or 0xfff to wait for the memory-cache channel's
            echo of the value in the apple,ptd-echo-entry entry, or 0xffe to
            read the entry the value names.
        - description: Value
    description:
      T6050. PTD entries written once the PMP runs, in order, which no driver
      otherwise writes. Set by the bootloader.

  apple,ptd-echo-entry:
    $ref: /schemas/types.yaml#/definitions/uint32
    maximum: 1023
    description:
      T6050. The PTD entry in which the memory-cache channel echoes a value,
      which the 0xfff steps of apple,ptd-boot wait on. Without it a sequence
      with such a step is not written at all. Set by the bootloader.

  operating-points-v2: true
  apple,dram-type: true
  apple,data-bus-width: true
  apple,dcs-state-count: true
  apple,peak-bandwidth-bytes-per-second: true
  apple,bandwidth-class-bytes-per-second: true

  apple,pmp:
    $ref: /schemas/types.yaml#/definitions/phandle
    description:
      The PMP that publishes this report, on SoCs where the host starts the
      PMP after a display handoff.

patternProperties:
  '^report@[0-9a-f]+$':
    type: object
    description: |
      A device whose power state the host reports to the PMP, provided as a
      power domain. The host sets the device's request bit after its parent
      domain powers on and clears it before the parent powers off, and waits
      for the PMP to acknowledge while the PMP runs.
    additionalProperties: false

    properties:
      compatible:
        oneOf:
          - items:
              - const: apple,t6020-pmp-v2-report-entry
              - const: apple,t6000-pmp-v2-report-entry
          - const: apple,t6000-pmp-v2-report-entry
          - const: apple,t8140-pmp-v2-report-entry
          - items:
              - enum:
                  - apple,t6030-pmp-v2-report-entry
                  - apple,t6031-pmp-v2-report-entry
                  - apple,t6041-pmp-v2-report-entry
                  - apple,t6050-pmp-v2-report-entry
                  - apple,t8112-pmp-v2-report-entry
                  - apple,t8122-pmp-v2-report-entry
              - const: apple,t6000-pmp-v2-report-entry

      reg:
        maxItems: 1
        description: PMP soc-device index of the device.

      label:
        description: Name of the power domain.

      '#power-domain-cells':
        const: 0

      power-domains:
        minItems: 1
        maxItems: 2

      apple,dvfs:
        $ref: /schemas/types.yaml#/definitions/uint32-array
        items:
          - description: SOC-DEV-DVFS entry holding the device's request.
          - description:
              Main-field performance level requested while powered (0-31).
              Legacy trees with apple,dvfs-request-class instead use this as
              that single request class's level.
            maximum: 31
        description:
          The device also has a performance request. While the domain is
          powered, after the PMP acknowledges the device, the host writes the
          complete request word (with the valid bit) to the entry once; before
          clearing the device request it writes every level as 0.

      apple,dvfs-request-levels:
        $ref: /schemas/types.yaml#/definitions/uint32-array
        minItems: 2
        maxItems: 10
        description:
          Request-class and level pairs. Classes 0x21 through 0x25 occupy the
          four-bit fields at bits 35:32 through 51:48; levels are 0 through
          15. Each class may occur once. These fields are combined with the
          main level in apple,dvfs into one 64-bit request word.

      apple,adt-dvfs:
        type: boolean
        description:
          The bootloader fills apple,dvfs and apple,dvfs-request-levels from
          this machine's ADT (the soc-device's SOC-DEV-DVFS slot and its named
          PMGR performance sources). Without this property the bootloader
          leaves the entry as it is. If the bootloader does not fill it, the
          entry sends no performance request.

      apple,dvfs-request-class:
        $ref: /schemas/types.yaml#/definitions/uint32
        enum: [0x21, 0x22, 0x23, 0x24, 0x25]
        deprecated: true
        description:
          Legacy single request class holding apple,dvfs's second cell. New
          trees use apple,dvfs-request-levels so a main level and multiple
          class levels can be requested together.

      apple,always-on:
        type: boolean
        description: Report the device as on from probe.

      apple,no-ack:
        type: boolean
        description:
          The PMP does not acknowledge this entry's requests; the host sets
          and clears the request bit without waiting for an acknowledgement.

      apple,soc-device-record:
        type: boolean
        description:
          The request and acknowledge bits are indexed by the index of the
          PMP soc-device record (apple,tunable-soc-device on the PMP) that
          holds this entry's device ID, instead of by reg. Only valid on a
          report whose PMP the host starts.

      apple,irq-safe:
        type: boolean
        description:
          The entry is the parent of IRQ-safe PMGR power states and is
          switched with interrupts disabled. Setting the state takes a
          spinlock and polls the acknowledgment atomically.

    required:
      - compatible
      - reg
      - label
      - '#power-domain-cells'

    allOf:
      - not:
          required:
            - apple,dvfs-request-levels
            - apple,dvfs-request-class

    dependentRequired:
      apple,dvfs-request-levels:
        - apple,dvfs
      apple,dvfs-request-class:
        - apple,dvfs

required:
  - compatible
  - reg

additionalProperties: false

examples:
  - |
    soc {
        #address-cells = <2>;
        #size-cells = <2>;

        pmp-report@3003c0000 {
            compatible = "apple,t8140-pmp-v2-report";
            reg = <3 0x003c0000 0 0x14000>;
            #address-cells = <1>;
            #size-cells = <0>;

            report@9 {
                compatible = "apple,t8140-pmp-v2-report-entry";
                reg = <0x9>;
                label = "pmp-gfx";
                #power-domain-cells = <0>;
            };
        };
    };
```

## Documentation/devicetree/bindings/rtc/apple,j700-pmu-rtc.yaml
```yaml
# SPDX-License-Identifier: (GPL-2.0-only OR BSD-2-Clause)
%YAML 1.2
---
$id: http://devicetree.org/schemas/rtc/apple,j700-pmu-rtc.yaml#
$schema: http://devicetree.org/meta-schemas/core.yaml#

title: Apple PMU real-time clocks

maintainers:
  - Ryan Murray <ryan@aurorasilicon.org>

description: |
  The PMU exposes a 65536 Hz counter and an alarm comparator over SPMI.
  The clock's offset is shared with the SMC RTC through a little-endian
  NVMEM cell: eight bytes of whole seconds on Baku (j700), or six bytes of
  signed 33.15 fixed-point seconds on the other PMUs. This function is a child of the
  PMIC NVMEM provider and uses that provider's SPMI register map.

allOf:
  - $ref: rtc.yaml#
  - if:
      not:
        properties:
          compatible:
            contains:
              const: apple,t6050-pmu-rtc
    then:
      required:
        - interrupts

properties:
  compatible:
    oneOf:
      - enum:
          - apple,j700-pmu-rtc
          - apple,t6000-pmu-rtc
          - apple,t6041-pmu-rtc
          - apple,t8112-pmu-rtc
      - items:
          - enum:
              - apple,t6050-pmu-rtc
              - apple,t8132-pmu-rtc
          - const: apple,t6041-pmu-rtc
      - items:
          - const: apple,t8122-pmu-rtc
          - const: apple,t8112-pmu-rtc

  interrupts:
    maxItems: 1
    description:
      The alarm's event in the SPMI controller's interrupt domain. It may be
      left out on T6050, whose SPMI controllers are not described as
      interrupt controllers. The host is then not told of an alarm while it
      runs; the alarm still wakes the SoC from a sleep.

  nvmem-cells:
    maxItems: 1
    description: The shared RTC offset, in the format described above.

  nvmem-cell-names:
    items:
      - const: rtc_offset

  wakeup-source: true

required:
  - compatible
  - nvmem-cells
  - nvmem-cell-names

unevaluatedProperties: false

examples:
  - |
    #include <dt-bindings/interrupt-controller/irq.h>
    #include <dt-bindings/spmi/spmi.h>

    pmic@e {
        compatible = "apple,baku-pmic", "apple,spmi-nvmem";
        reg = <0xe SPMI_USID>;

        rtc {
            compatible = "apple,j700-pmu-rtc";
            interrupt-parent = <&spmi>;
            interrupts = <2 IRQ_TYPE_EDGE_RISING>;
            nvmem-cells = <&rtc_offset>;
            nvmem-cell-names = "rtc_offset";
            wakeup-source;
        };
    };
```

## Documentation/devicetree/bindings/soc/apple/apple,aop.yaml
```yaml
# SPDX-License-Identifier: (GPL-2.0-only OR BSD-2-Clause)
%YAML 1.2
---
$id: http://devicetree.org/schemas/soc/apple/apple,aop.yaml#
$schema: http://devicetree.org/meta-schemas/core.yaml#

title: Apple Always-On Processor

maintainers:
  - Ryan Murray <81541646+RyanTheTide@users.noreply.github.com>

description: |
  The Always-On Processor runs firmware that owns audio and sensor services.
  The host uses an RTKit mailbox and a DART stream to exchange messages and
  buffers. Service nodes do not have independent host MMIO or interrupts.

select:
  properties:
    compatible:
      items:
        - enum:
            - apple,t6020-aop
            - apple,t8112-aop
  required:
    - compatible

properties:
  compatible:
    oneOf:
      - enum:
          - apple,t6020-aop
          - apple,t8112-aop
      - items:
          - const: apple,t8122-aop
          - const: apple,t6020-aop

  reg:
    items:
      - description: Shared SRAM
      - description: Coprocessor registers

  mboxes:
    maxItems: 1

  mbox-names:
    const: mbox

  iommus:
    maxItems: 1

  memory-region:
    minItems: 1
    maxItems: 8
    description:
      The firmware's external code, data and log segments in DRAM, reserved
      by the bootloader with their IOVAs in iommu-addresses (T6040, T8122 and
      T8132). Absent when the bootloader did not reserve them.

  audio:
    $ref: /schemas/sound/apple,aop-audio.yaml#

  als:
    $ref: /schemas/iio/light/apple,aop-als.yaml#

  las:
    $ref: /schemas/iio/position/apple,aop-las.yaml#

  accel:
    $ref: /schemas/iio/imu/apple,aop-motion.yaml#

  gyro:
    $ref: /schemas/iio/imu/apple,aop-motion.yaml#

required:
  - compatible
  - reg
  - mboxes
  - mbox-names
  - iommus

additionalProperties: false
```
