## Documentation/devicetree/bindings/media/apple,isp.yaml
```yaml
# SPDX-License-Identifier: (GPL-2.0-only OR BSD-2-Clause)
%YAML 1.2
---
$id: http://devicetree.org/schemas/media/apple,isp.yaml#
$schema: http://devicetree.org/meta-schemas/core.yaml#

title: Apple Image Signal Processor

maintainers:
  - Jonathan Goyvaerts <jonathan.goyvaerts@gmail.com>

description:
  The ISP controls the attached camera sensor and processes its frames using
  a coprocessor. The host exchanges commands and image buffers through three
  DART instances. The memory handoff identifies either the allocation heap or
  separate firmware text, data and heap regions.

select:
  properties:
    compatible:
      contains:
        enum: ['apple,t6020-isp', 'apple,t6041-isp', 'apple,t8112-isp']
  required:
    - compatible

properties:
  compatible:
    items:
      - enum:
          - apple,t6020-isp
          - apple,t6041-isp
          - apple,t8112-isp
      - const: apple,isp

  reg:
    items:
      - description: Coprocessor registers up to its control block
      - description: Mailbox interrupt registers
      - description: Firmware handshake registers
      - description: Mailbox doorbell registers

  reg-names:
    items:
      - const: coproc
      - const: mbox
      - const: gpio
      - const: mbox2

  interrupts:
    maxItems: 1

  iommus:
    items:
      - description: First ISP DART stream
      - description: Second ISP DART stream
      - description: Third ISP DART stream

  power-domains:
    minItems: 7
    maxItems: 18
    description: Register-backed power domains required by the ISP.

  memory-region:
    minItems: 1
    maxItems: 3
    description: Firmware memory and the host allocation heap.

  memory-region-names:
    minItems: 1
    maxItems: 3
    items:
      enum: [text, data, heap]

  apple,dart-vm-size:
    $ref: /schemas/types.yaml#/definitions/uint64
    description:
      Size in bytes of the host allocation aperture used by the ISP driver.

  apple,platform-id:
    $ref: /schemas/types.yaml#/definitions/uint32
    description:
      Platform identifier passed in the firmware boot descriptor.

  apple,cam-connections-scheme:
    $ref: /schemas/types.yaml#/definitions/uint32
    description:
      Camera connection layout of the board passed in the firmware boot
      descriptor.

  apple,temporal-filter:
    $ref: /schemas/types.yaml#/definitions/uint32
    description:
      Firmware temporal-filter strength selected for the attached sensor.

  apple,camera-indicator:
    $ref: /schemas/types.yaml#/definitions/phandle
    description:
      Optional. The display coprocessor asked to present the software camera
      indicator while the camera streams. The request is best-effort and the
      camera streams whether or not the indicator is shown. The indicator is
      software, not a privacy guarantee.

  sensor-presets:
    type: object
    description:
      Sensor firmware presets and the host output geometry associated with them.
    patternProperties:
      "^preset[0-9]+$":
        type: object
        properties:
          apple,config-index:
            $ref: /schemas/types.yaml#/definitions/uint32
            description: Sensor configuration index understood by the firmware
          apple,input-size:
            $ref: /schemas/types.yaml#/definitions/uint32-array
            items:
              - description: Input width in pixels
              - description: Input height in pixels
            description: Sensor input dimensions
          apple,output-size:
            $ref: /schemas/types.yaml#/definitions/uint32-array
            items:
              - description: Output width in pixels
              - description: Output height in pixels
            description: Delivered frame dimensions
          apple,crop:
            $ref: /schemas/types.yaml#/definitions/uint32-array
            items:
              - description: Horizontal crop origin in pixels
              - description: Vertical crop origin in pixels
              - description: Crop width in pixels
              - description: Crop height in pixels
            description: Cropped sensor rectangle
        required:
          - apple,config-index
          - apple,input-size
          - apple,output-size
          - apple,crop
        additionalProperties: false
    additionalProperties: false

required:
  - compatible
  - reg
  - reg-names
  - interrupts
  - iommus
  - power-domains
  - apple,dart-vm-size

allOf:
  - if:
      properties:
        compatible:
          contains:
            const: apple,t6041-isp
    then:
      properties:
        power-domains:
          items:
            - description: ISP system domain
            - description: ISP CPU domain
            - description: ISP FE domain
            - description: ISP DPRX domain
            - description: ISP secure domain
            - description: ISP BE domain
            - description: ISP CLR domain
            - description: Camera sensor domain
        memory-region:
          minItems: 3
        memory-region-names:
          items:
            - const: text
            - const: data
            - const: heap
      required:
        - memory-region
        - memory-region-names
        - apple,platform-id
        - sensor-presets
    else:
      properties:
        memory-region:
          maxItems: 1
        memory-region-names:
          items:
            - const: heap
  - if:
      not:
        properties:
          status:
            const: disabled
        required:
          - status
    then:
      required:
        - memory-region
        - memory-region-names
        - apple,platform-id
        - sensor-presets

additionalProperties: false

examples:
  - |
    #include <dt-bindings/interrupt-controller/apple-aic.h>
    #include <dt-bindings/interrupt-controller/irq.h>

    soc {
        #address-cells = <2>;
        #size-cells = <2>;

        isp@580000000 {
            compatible = "apple,t6041-isp", "apple,isp";
            reg = <0x5 0x80000000 0x0 0x1604000>,
                  <0x5 0x82924000 0x0 0x40>,
                  <0x5 0x829241d0 0x0 0x20>,
                  <0x5 0x82924464 0x0 0x10>;
            reg-names = "coproc", "mbox", "gpio", "mbox2";
            interrupt-parent = <&aic>;
            interrupts = <AIC_IRQ 0x286 IRQ_TYPE_LEVEL_HIGH>;
            iommus = <&isp_dart0 0>, <&isp_dart1 0>, <&isp_dart2 0>;
            power-domains = <&ps_isp_sys>, <&ps_isp_cpu>, <&ps_isp_fe>,
                            <&ps_isp_dprx>, <&ps_isp_secure>, <&ps_isp_be>,
                            <&ps_isp_clr>, <&ps_ispsens0>;
            memory-region = <&isp_fw_text>, <&isp_fw_data>, <&isp_heap>;
            memory-region-names = "text", "data", "heap";
            apple,dart-vm-size = /bits/ 64 <0xde600000>;
            apple,platform-id = <5>;
            apple,cam-connections-scheme = <0x10>;

            sensor-presets {
                preset0 {
                    apple,config-index = <5>;
                    apple,input-size = <1920 2160>;
                    apple,output-size = <1920 1080>;
                    apple,crop = <0 0 1920 1080>;
                };
            };
        };
    };
```

## Documentation/devicetree/bindings/media/apple,prores.yaml
```yaml
# SPDX-License-Identifier: (GPL-2.0-only OR BSD-2-Clause)
%YAML 1.2
---
$id: http://devicetree.org/schemas/media/apple,prores.yaml#
$schema: http://devicetree.org/meta-schemas/core.yaml#

title: Apple Silicon ProRes codec (APR)

maintainers:
  - Ryan Murray <ryan@aurorasilicon.org>

description: |
  The APR is a directly programmed ProRes engine with its own DART. Jobs are
  descriptors in a DMA ring; the engine signals completion with an
  interrupt. On T8132, T6041 and T6050 a per-machine initialization table,
  apple/prores-t8132-init.bin, apple/prores-t6041-init.bin or
  apple/prores-t6050-init.bin, takes the place of any rows built into the
  driver. Other supported variants have no
  firmware.
  The engine's power domain also resets it.

select:
  properties:
    compatible:
      contains:
        enum:
          - apple,t6000-prores
          - apple,t6020-prores
          - apple,t6021-prores
          - apple,t6022-prores
          - apple,t6030-prores
          - apple,t6031-prores
          - apple,t6032-prores
          - apple,t6041-prores
          - apple,t8112-prores
          - apple,t8122-prores
          - apple,t8132-prores
          - apple,t6050-prores
          - apple,t8140-prores
          - apple,t8142-prores
  required:
    - compatible

properties:
  compatible: true

allOf:
  - if:
      properties:
        compatible:
          contains:
            const: apple,t8132-prores
    then:
      properties:
        reg:
          minItems: 3
          maxItems: 3
  - if:
      properties:
        compatible:
          contains:
            enum:
              - apple,t8132-prores
              - apple,t6050-prores
              - apple,t8142-prores
      required:
        - compatible
    then:
      properties:
        compatible:
          items:
            - enum:
                - apple,t8132-prores
                - apple,t6050-prores
                - apple,t8142-prores
            - const: apple,prores

        reg:
          minItems: 2
          maxItems: 5
          description:
            Three windows on T8132. On T6050 and T8142 each ProRes instance has
            up to five, named core, wrapper, aux (SCODEC system), ctrl and ctrl1
            (SCODEC control).

        reg-names:
          minItems: 2
          maxItems: 5

        interrupts:
          minItems: 2
          maxItems: 2

        power-domains:
          maxItems: 1

        resets:
          maxItems: 1

        iommus:
          maxItems: 1

      required:
        - compatible
        - reg
        - interrupts
        - power-domains
        - iommus
    else:
      allOf:
        - if:
            properties:
              compatible:
                contains:
                  enum:
                    - apple,t6032-prores
            required:
              - compatible
          then:
            properties:
              compatible:
                items:
                  - const: apple,t6032-prores
                  - const: apple,prores

              reg:
                minItems: 2
                maxItems: 3

              interrupts:
                maxItems: 1

              power-domains:
                maxItems: 1

              iommus:
                minItems: 1
                maxItems: 2

            required:
              - compatible
              - reg
              - interrupts
              - power-domains
              - iommus
          else:
            properties:
              compatible:
                oneOf:
                  - const: apple,t8140-prores
                  - items:
                      - enum:
                          - apple,t6000-prores
                          - apple,t6020-prores
                          - apple,t6021-prores
                          - apple,t6022-prores
                          - apple,t6030-prores
                          - apple,t6031-prores
                          - apple,t6041-prores
                          - apple,t8112-prores
                          - apple,t8122-prores
                      - const: apple,prores

              reg:
                minItems: 2
                maxItems: 3
                description: Engine, wrapper and generation-specific auxiliary register windows.

              reg-names:
                minItems: 2
                items:
                  - const: core
                  - const: wrapper
                  - const: aux

              interrupts:
                minItems: 1
                maxItems: 2

              iommus:
                minItems: 1
                maxItems: 2

              power-domains:
                minItems: 1
                items:
                  - description: The engine's power domain
                  - description: Performance request held while the engine works

              power-domain-names:
                minItems: 1
                items:
                  - const: core
                  - const: perf

              resets:
                maxItems: 1

            required:
              - compatible
              - reg
              - interrupts
              - iommus
              - power-domains

            allOf:
              - if:
                  properties:
                    compatible:
                      contains:
                        enum:
                          - apple,t6030-prores
                          - apple,t6031-prores
                          - apple,t8122-prores
                then:
                  properties:
                    reg:
                      minItems: 2
                      maxItems: 3
                    power-domains:
                      maxItems: 1
              - if:
                  properties:
                    compatible:
                      contains:
                        enum:
                          - apple,t6020-prores
                          - apple,t6021-prores
                          - apple,t6022-prores
                          - apple,t8112-prores
                then:
                  properties:
                    reg:
                      maxItems: 2
                    reg-names:
                      maxItems: 2
              - if:
                  properties:
                    compatible:
                      contains:
                        enum:
                          - apple,t6041-prores
                then:
                  properties:
                    reg:
                      minItems: 3
                      maxItems: 3
                    reg-names:
                      minItems: 3
                      maxItems: 3
                    interrupts:
                      maxItems: 1
                    iommus:
                      maxItems: 1
                  required:
                    - resets
                    - reg-names
              - if:
                  properties:
                    compatible:
                      contains:
                        enum:
                          - apple,t8140-prores
                then:
                  properties:
                    reg:
                      maxItems: 2
                    reg-names:
                      maxItems: 2
                    iommus:
                      maxItems: 1
                  required:
                    - reg-names

            additionalProperties: false

unevaluatedProperties: false

examples:
  - |
    #include <dt-bindings/interrupt-controller/apple-aic.h>
    #include <dt-bindings/interrupt-controller/irq.h>

    soc {
        #address-cells = <2>;
        #size-cells = <2>;

        video-codec@295000000 {
            compatible = "apple,t8140-prores";
            reg = <0x2 0x95000000 0x0 0x4000>,
                  <0x2 0x94000000 0x0 0x8000>;
            reg-names = "core", "wrapper";
            interrupt-parent = <&aic>;
            interrupts = <AIC_IRQ 1260 IRQ_TYPE_LEVEL_HIGH>,
                         <AIC_IRQ 1259 IRQ_TYPE_LEVEL_HIGH>;
            iommus = <&apr_dart 0>;
            power-domains = <&ps_prores>;
            resets = <&ps_prores>;
        };
    };
```
