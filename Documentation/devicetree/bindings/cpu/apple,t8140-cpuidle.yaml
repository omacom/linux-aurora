## Documentation/devicetree/bindings/firmware/apple,atc-handoff.yaml
```yaml
# SPDX-License-Identifier: GPL-2.0-only OR BSD-2-Clause
%YAML 1.2
---
$id: http://devicetree.org/schemas/firmware/apple,atc-handoff.yaml#
$schema: http://devicetree.org/meta-schemas/core.yaml#

title: Apple Type-C (ATC) port boot ownership handoff interface

maintainers:
  - Dj <hey@djdev.me>

description: |
  A Type-C port whose ATC the boot producer may be using, for example as its
  USB debug port. The port's devices start disabled. This firmware interface
  identifies the port's PHY and the group the producer may enable after
  relinquishing USB/debug ownership, proving no DMA was retained, and
  supplying the current machine's PHY tunables. Shared providers are
  excluded. Older producers leave the group disabled; Linux does not
  activate it.

properties:
  compatible:
    const: apple,atc-handoff

  apple,phy:
    $ref: /schemas/types.yaml#/definitions/phandle
    description: |
      The port's ATC PHY. It is also a member of apple,devices.

  apple,devices:
    $ref: /schemas/types.yaml#/definitions/phandle-array
    minItems: 1
    maxItems: 32
    items:
      maxItems: 1
    description: |
      The port's own devices: its power domains, PHY and mailbox, USB DARTs
      and DRD, port controller, USB4 router and its mailbox/NHI/DART, PCIe
      tunnel parent/DART/root controller, and display crossbar. Every member
      must be disabled until handoff. Do not include providers shared with
      other ports, such as the AOP GPIO, AUSS or CIO reset providers.

required:
  - compatible
  - apple,phy
  - apple,devices

additionalProperties: false
```

## Documentation/devicetree/bindings/iio/light/apple,aop-als.yaml
```yaml
# SPDX-License-Identifier: (GPL-2.0-only OR BSD-2-Clause)
%YAML 1.2
---
$id: http://devicetree.org/schemas/iio/light/apple,aop-als.yaml#
$schema: http://devicetree.org/meta-schemas/core.yaml#

title: Apple AOP ambient light sensor service

maintainers:
  - Ryan Murray <81541646+RyanTheTide@users.noreply.github.com>

description: |
  The service is supplied by the parent Always-On Processor. Firmware and
  calibration handoff determine its availability. It has no independent
  application-processor register window or interrupt.

select:
  properties:
    compatible:
      contains:
        enum:
          - apple,t6020-aop-als
          - apple,t6030-aop-als
          - apple,t6050-aop-als
          - apple,t8112-aop-als
          - apple,t8142-aop-als
  required:
    - compatible

properties:
  compatible:
    oneOf:
      - items:
          - enum:
              - apple,t6020-aop-als
              - apple,t6050-aop-als
              - apple,t8112-aop-als
              - apple,t8142-aop-als
          - const: apple,aop-als
      - items:
          - const: apple,t6030-aop-als
          - const: apple,t6020-aop-als
          - const: apple,aop-als

  firmware-name:
    maxItems: 1
    description: Calibration file the driver sends the sensor over the AOP setup port.

required:
  - compatible

additionalProperties: false
```

## Documentation/devicetree/bindings/input/apple,dockchannel-hid.yaml
```yaml
# SPDX-License-Identifier: (GPL-2.0-only OR BSD-2-Clause)
%YAML 1.2
---
$id: http://devicetree.org/schemas/input/apple,dockchannel-hid.yaml#
$schema: http://devicetree.org/meta-schemas/core.yaml#

title: Apple DockChannel HID transport

maintainers:
  - Ryan Murray <ryan@aurorasilicon.org>

description: |
  Apple laptops from the M2 generation on connect the built-in keyboard and
  trackpad to the MTP (multi-touch processor) coprocessor, which exposes them
  as HID devices over a DockChannel FIFO pair. The coprocessor announces its
  interfaces by name when it boots. Each interface that the operating system
  should use has a child node of the same name; announced interfaces without
  a node are ignored, and so are interfaces whose node is disabled.

  The multi-touch interface may need firmware that the host sends after the
  coprocessor has booted, followed by a power cycle of the trackpad. Two
  power methods exist. With power method 1 the coprocessor sequences the
  trackpad itself and asks the host to pulse a reset line when it needs one.
  With power method 2 the host announces each power transition to the
  coprocessor, drives the reset line of the trackpad analog front end (AFE)
  itself and then confirms the transition. On systems with firmware-managed
  reset, the same notifications bracket a firmware-owned transition and the
  host waits 50 ms during power-on without operating a GPIO.

properties:
  compatible:
    oneOf:
      - const: apple,dockchannel-hid
      - items:
          - const: apple,t6041-dockchannel-hid
          - const: apple,dockchannel-hid

  reg:
    minItems: 4
    maxItems: 4
    description:
      Host and remote FIFO configuration and data windows, in the order
      given by reg-names.

  reg-names:
    oneOf:
      - items:
          - const: config
          - const: data
          - const: rmt-config
          - const: rmt-data
      - items:
          - const: rmt-config
          - const: rmt-data
          - const: config
          - const: data

  interrupts:
    items:
      - description: Transmit FIFO threshold
      - description: Receive FIFO threshold

  interrupt-names:
    items:
      - const: tx
      - const: rx

  iommus:
    minItems: 1
    maxItems: 2
    description:
      DART streams of the transport. A second stream carries the coprocessor's
      writes into the receive ring on firmware that has one.

  apple,fifo-size:
    $ref: /schemas/types.yaml#/definitions/uint32
    minimum: 1
    description: Capacity in bytes of each DockChannel FIFO.

  apple,helper-cpu:
    $ref: /schemas/types.yaml#/definitions/phandle
    description:
      The RTKit helper node of the coprocessor at the remote end of the FIFO.

  apple,afe-reset-gpios:
    maxItems: 1
    description:
      Reset line of the trackpad analog front end, described with the level
      that asserts the reset as its active level. With power method 1 the
      coprocessor asks the host to pulse it. With power method 2 the host
      asserts it while the multi-touch interface is powered off and releases
      it when the interface is powered on.

  apple,stm-reset-gpios:
    maxItems: 1
    description:
      Reset line of the STM interface, pulsed on the coprocessor's request.

  apple,afe-smc:
    $ref: /schemas/types.yaml#/definitions/phandle
    description:
      The SMC whose gp1c key powers the trackpad analog front end. With it
      the host drives the key low to power the multi-touch interface on
      and high to power it off, between the coprocessor's power transition
      notifications.

  apple,no-stm:
    type: boolean
    description:
      The coprocessor firmware has no STM interface. The STM normally reports
      the machine's USB vendor and product identifiers, keyboard type and
      serial number before the other interfaces are started; without it the
      HID devices are registered with the Apple vendor identifier and no
      product identifier.

  keyboard:
    type: object
    additionalProperties: false
    description: The built-in keyboard.

    properties:
      hid-country-code:
        $ref: /schemas/types.yaml#/definitions/uint32
        maximum: 255
        description:
          HID country code of the keyboard, which the coprocessor does not
          report. The bootloader fills it in from the machine's own device
          tree.

      apple,keyboard-layout-id:
        $ref: /schemas/types.yaml#/definitions/uint32
        description:
          Apple's keyboard layout identifier, exposed to user space through
          the HID device's apple_layout_id attribute.

  multi-touch:
    type: object
    additionalProperties: false
    description: The built-in trackpad.

    properties:
      compatible:
        const: apple,j700-multitouch
        description:
          The trackpad sends the report layout of the J700 (MacBook Neo), a
          32-byte header followed by the contacts and an 8-byte trailer,
          instead of the 38-byte header layout of the earlier laptops.

      firmware-name:
        maxItems: 1
        description:
          Name of the trackpad firmware that the host sends to the
          coprocessor when the interface is first opened.

      apple,power-method:
        $ref: /schemas/types.yaml#/definitions/uint32
        enum: [1, 2]
        default: 1
        description:
          The power sequencing protocol of the coprocessor firmware, as
          described above. Power method 2 requires apple,afe-reset-gpios
          unless apple,firmware-managed-reset is present.

      apple,firmware-managed-reset:
        type: boolean
        description:
          The coprocessor owns the trackpad reset signal. The host sends
          power method 2 notifications without controlling an AFE GPIO.
          Mutually exclusive with apple,afe-reset-gpios on the parent.

    allOf:
      - if:
          required:
            - apple,firmware-managed-reset
        then:
          properties:
            apple,power-method:
              const: 2
          required:
            - apple,power-method
            - firmware-name

  stm:
    type: object
    additionalProperties: false
    description:
      The system management interface, which reports the machine
      identifiers.

  actuator:
    type: object
    additionalProperties: false
    description: The trackpad haptic actuator.

    properties:
      apple,click-strength:
        $ref: /schemas/types.yaml#/definitions/uint32-array
        description:
          Strengths at which the actuator firmware plays its own click
          waveforms while it is device-controlled, first on press and then on
          release. The coprocessor firmware starts with a weak placeholder
          strength, so the host writes these over it. When absent, the
          firmware's strength is kept.
        items:
          - description: Strength of the press click.
            minimum: 1
            maximum: 255
          - description: Strength of the release click.
            minimum: 1
            maximum: 255

      apple,sleep-report:
        $ref: /schemas/types.yaml#/definitions/uint8-array
        minItems: 1
        maxItems: 65524
        description:
          A feature report, starting with its report ID, that the host sets
          on this interface before it tells the coprocessor of a system sleep
          that removes power, in one command frame, which holds up to 65524
          bytes. When absent, nothing is sent. Filled in by the bootloader.

  tp_accel:
    type: object
    additionalProperties: false
    description: The trackpad accelerometer.

  tp-accel:
    type: object
    additionalProperties: false
    description:
      The trackpad accelerometer, under the name that the T6041 coprocessor
      firmware announces.

  kiwi:
    type: object
    additionalProperties: false
    description:
      The touchscreen of the MacBook Pros with a PROLED XDR display, an
      interface of the same coprocessor as the trackpad.

    properties:
      firmware-name:
        maxItems: 1
        description:
          Name of the touchscreen firmware that the host sends to the
          coprocessor when the interface is first opened.

  mtp:
    type: object
    additionalProperties: false
    description:
      A vendor HID interface of the coprocessor, announced by the T6041
      firmware.

required:
  - compatible
  - reg
  - reg-names
  - interrupts
  - interrupt-names
  - iommus
  - apple,fifo-size
  - apple,helper-cpu

additionalProperties: false

allOf:
  - if:
      properties:
        compatible:
          not:
            contains:
              const: apple,t6041-dockchannel-hid
    then:
      properties:
        apple,afe-smc: false
  - if:
      properties:
        multi-touch:
          required:
            - apple,firmware-managed-reset
      required:
        - multi-touch
    then:
      properties:
        apple,afe-reset-gpios: false

examples:
  - |
    #include <dt-bindings/gpio/gpio.h>
    #include <dt-bindings/interrupt-controller/irq.h>

    // MacBook Air (M2, 2022)
    input@8000 {
        compatible = "apple,dockchannel-hid";
        reg = <0x8000 0x4000>,
              <0xc000 0x4000>,
              <0x0000 0x4000>,
              <0x4000 0x4000>;
        reg-names = "config", "data", "rmt-config", "rmt-data";
        iommus = <&mtp_dart 1>;
        interrupts = <2 IRQ_TYPE_LEVEL_HIGH>,
                     <3 IRQ_TYPE_LEVEL_HIGH>;
        interrupt-names = "tx", "rx";
        apple,fifo-size = <0x800>;
        apple,helper-cpu = <&mtp>;
        apple,afe-reset-gpios = <&smc_gpio 8 GPIO_ACTIVE_LOW>;
        apple,stm-reset-gpios = <&smc_gpio 24 GPIO_ACTIVE_LOW>;

        multi-touch {
            firmware-name = "apple/tpmtfw-j413.bin";
        };

        keyboard {
            hid-country-code = <0>;
            apple,keyboard-layout-id = <0>;
        };

        stm {
        };

        actuator {
            apple,click-strength = <0xc0 0x6e>;
        };

        tp_accel {
        };
    };
  - |
    #include <dt-bindings/gpio/gpio.h>
    #include <dt-bindings/interrupt-controller/irq.h>

    // MacBook Neo (J700)
    input@8000 {
        compatible = "apple,dockchannel-hid";
        reg = <0x8000 0x4000>,
              <0xc000 0x4000>,
              <0x0000 0x4000>,
              <0x4000 0x4000>;
        reg-names = "config", "data", "rmt-config", "rmt-data";
        iommus = <&mtp_dart 0>;
        interrupts = <2 IRQ_TYPE_LEVEL_HIGH>,
                     <3 IRQ_TYPE_LEVEL_HIGH>;
        interrupt-names = "tx", "rx";
        apple,fifo-size = <0x800>;
        apple,helper-cpu = <&mtp>;
        apple,no-stm;
        /* SMC pcIO output 19; level 1 asserts the reset */
        apple,afe-reset-gpios = <&smc_gpio 19 GPIO_ACTIVE_HIGH>;

        multi-touch {
            compatible = "apple,j700-multitouch";
            firmware-name = "apple/tpmtfw-j700.bin";
            apple,power-method = <2>;
        };

        keyboard {
            hid-country-code = <0>;
            apple,keyboard-layout-id = <0>;
        };
    };
```

## Documentation/devicetree/bindings/iommu/apple,dart-smmu.yaml
```yaml
# SPDX-License-Identifier: (GPL-2.0-only OR BSD-2-Clause)
%YAML 1.2
---
$id: http://devicetree.org/schemas/iommu/apple,dart-smmu.yaml#
$schema: http://devicetree.org/meta-schemas/core.yaml#

title: Apple system MMU companion interface

maintainers:
  - Ryan Murray <81541646+RyanTheTide@users.noreply.github.com>

description: |
  Hardware resources of the Apple Silicon system MMU companion interface.
  The interface is described for discovery and must remain disabled until
  its ownership, initialization and shutdown are supported. Register windows
  are listed in hardware resource order; firmware configuration and tuning
  data are supplied by the boot firmware rather than this binding.

select:
  properties:
    compatible:
      contains:
        enum:
          - apple,t6030-dart-smmu
          - apple,t6031-dart-smmu
          - apple,t6032-dart-smmu
          - apple,t8122-dart-smmu
          - apple,t8132-dart-smmu
  required:
    - compatible

properties:
  compatible:
    items:
      - enum:
          - apple,t8122-dart-smmu
          - apple,t6030-dart-smmu
          - apple,t6031-dart-smmu
          - apple,t6032-dart-smmu
          - apple,t8132-dart-smmu
      - const: apple,dart-smmu

  reg:
    maxItems: 1

  power-domains:
    description:
      The power domain of the engine the interface sits beside. The interface
      has no power gate of its own; its registers are reachable only while that
      domain is on.
    maxItems: 1

required:
  - compatible
  - reg

additionalProperties: false
```
