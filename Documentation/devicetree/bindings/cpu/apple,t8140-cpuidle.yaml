## Documentation/devicetree/bindings/media/apple,t8132-isp.yaml
```yaml
# SPDX-License-Identifier: (GPL-2.0-only OR BSD-2-Clause)
%YAML 1.2
---
$id: http://devicetree.org/schemas/media/apple,t8132-isp.yaml#
$schema: http://devicetree.org/meta-schemas/core.yaml#

title: Apple T8132 Image Signal Processor

maintainers:
  - Erik Bourget <erik@ebourget.net>

description:
  The T8132 ISP controls the attached camera sensor and processes its frames
  through firmware the bootloader loads. The firmware segments are described
  as reserved memory mapped at the addresses the firmware runs them at. The
  host exchanges commands and image buffers through three DART instances; the
  first one also has the address filter registers.

select:
  properties:
    compatible:
      contains:
        const: apple,t8132-isp
  required:
    - compatible

properties:
  compatible:
    items:
      - const: apple,t8132-isp
      - const: apple,isp

  reg:
    items:
      - description: Coprocessor registers up to its control block
      - description: Mailbox interrupt registers
      - description: Firmware handshake registers
      - description: Mailbox doorbell registers

  reg-names:
    items:
      - const: coproc
      - const: mbox
      - const: gpio
      - const: mbox2

  interrupts:
    maxItems: 1

  iommus:
    items:
      - description: First ISP DART stream; this DART has the address filter bank
      - description: Second ISP DART stream
      - description: Third ISP DART stream

  power-domains:
    items:
      - description: ISP system domain
      - description: ISP CPU domain
      - description: ISP CPU core 0 domain
      - description: ISP CPU core 1 domain
      - description: ISP FE domain
      - description: ISP DPRX domain
      - description: ISP secure domain
      - description: ISP STS0 domain
      - description: ISP STS1 domain
      - description: ISP Pearl domain
      - description: ISP BE domain
      - description: ISP CLR domain
      - description: ISP CVD domain
      - description: ISP CVM domain
      - description: First camera sensor domain
      - description: Second camera sensor domain

  memory-region:
    items:
      - description: Firmware text loaded by the bootloader
      - description: Firmware data loaded by the bootloader
      - description: Firmware main memory window; host allocations follow it

  memory-region-names:
    items:
      - const: text
      - const: data
      - const: heap

  apple,dart-vm-size:
    $ref: /schemas/types.yaml#/definitions/uint64
    description:
      Size in bytes of the host allocation aperture used by the ISP driver.

  apple,platform-id:
    $ref: /schemas/types.yaml#/definitions/uint32
    description:
      Platform identifier passed in the firmware boot descriptor.

  apple,cam-connections-scheme:
    $ref: /schemas/types.yaml#/definitions/uint32
    description:
      Camera connection layout of the board passed in the firmware boot
      descriptor.

  apple,temporal-filter:
    $ref: /schemas/types.yaml#/definitions/uint32
    description:
      Firmware temporal-filter strength selected for the attached sensor.

  apple,dapf-ranges:
    $ref: /schemas/types.yaml#/definitions/uint64-matrix
    minItems: 1
    maxItems: 16
    items:
      items:
        - description: Physical start address, inclusive
        - description: Physical end address, inclusive
    description:
      The address filter windows of the first ISP DART, in record order, as
      the bootloader finds them in its hardware description. Each pair holds
      inclusive 64-bit physical bounds, not a base and a length. The filter
      loses them when the ISP powers down, so they are programmed again
      before the firmware starts. The firmware reaches these registers
      through identity mappings of the 16 KiB pages that contain them.

  sensor-presets:
    type: object
    description:
      Sensor firmware presets and the host output geometry associated with them.
    patternProperties:
      "^preset[0-9]+$":
        type: object
        properties:
          apple,config-index:
            $ref: /schemas/types.yaml#/definitions/uint32
            description: Sensor configuration index understood by the firmware
          apple,input-size:
            $ref: /schemas/types.yaml#/definitions/uint32-array
            items:
              - description: Input width in pixels
              - description: Input height in pixels
            description: Sensor input dimensions
          apple,output-size:
            $ref: /schemas/types.yaml#/definitions/uint32-array
            items:
              - description: Output width in pixels
              - description: Output height in pixels
            description: Delivered frame dimensions
          apple,crop:
            $ref: /schemas/types.yaml#/definitions/uint32-array
            items:
              - description: Horizontal crop origin in pixels
              - description: Vertical crop origin in pixels
              - description: Crop width in pixels
              - description: Crop height in pixels
            description: Cropped sensor rectangle
        required:
          - apple,config-index
          - apple,input-size
          - apple,output-size
          - apple,crop
        additionalProperties: false
    additionalProperties: false

required:
  - compatible
  - reg
  - reg-names
  - interrupts
  - iommus
  - power-domains
  - memory-region
  - memory-region-names
  - apple,dart-vm-size
  - apple,platform-id
  - sensor-presets

additionalProperties: false

examples:
  - |
    #include <dt-bindings/interrupt-controller/apple-aic.h>
    #include <dt-bindings/interrupt-controller/irq.h>

    soc {
        #address-cells = <2>;
        #size-cells = <2>;

        isp@48c000000 {
            compatible = "apple,t8132-isp", "apple,isp";
            reg = <0x4 0x8c000000 0x0 0x1604000>,
                  <0x4 0x8e924000 0x0 0x40>,
                  <0x4 0x8e9241d0 0x0 0x20>,
                  <0x4 0x8e924464 0x0 0x10>;
            reg-names = "coproc", "mbox", "gpio", "mbox2";
            interrupt-parent = <&aic>;
            interrupts = <AIC_IRQ 369 IRQ_TYPE_LEVEL_HIGH>;
            iommus = <&isp_dart0 0>, <&isp_dart1 0>, <&isp_dart2 0>;
            power-domains = <&ps_isp_sys>, <&ps_isp_cpu>,
                            <&ps_isp_cpu_core0>, <&ps_isp_cpu_core1>,
                            <&ps_isp_fe>, <&ps_isp_dprx>, <&ps_isp_secure>,
                            <&ps_isp_sts0>, <&ps_isp_sts1>, <&ps_isp_pearl>,
                            <&ps_isp_be>, <&ps_isp_clr>, <&ps_isp_cvd>,
                            <&ps_isp_cvm>, <&ps_ispsens0>, <&ps_ispsens1>;
            memory-region = <&isp_fw_text>, <&isp_fw_data>, <&isp_heap>;
            memory-region-names = "text", "data", "heap";
            apple,dart-vm-size = /bits/ 64 <0xdec00000>;
            apple,platform-id = <0x17>;
            apple,dapf-ranges = /bits/ 64 <0x380704000 0x380704063>,
                                /bits/ 64 <0x382824000 0x382824004>;

            sensor-presets {
                preset0 {
                    apple,config-index = <5>;
                    apple,input-size = <1920 2160>;
                    apple,output-size = <1920 1080>;
                    apple,crop = <0 0 1920 1080>;
                };
            };
        };
    };
```

## Documentation/devicetree/bindings/media/apple,t8140-ave.yaml
```yaml
# SPDX-License-Identifier: (GPL-2.0-only OR BSD-2-Clause)
%YAML 1.2
---
$id: http://devicetree.org/schemas/media/apple,t8140-ave.yaml#
$schema: http://devicetree.org/meta-schemas/core.yaml#

title: Apple video encoder

maintainers:
  - Miguel Cruz <7362641+Acelogic@users.noreply.github.com>

description: |
  The AVE coprocessor encodes video using firmware preloaded by the bootloader.
  DART instances translate its DMA streams. The bootloader supplies the firmware
  memory handoff and IOVA mappings.

select:
  properties:
    compatible:
      contains:
        enum:
          - apple,t6000-ave
          - apple,t6020-ave
          - apple,t6021-ave
          - apple,t6022-ave
          - apple,t6030-ave
          - apple,t6031-ave
          - apple,t6032-ave
          - apple,t6041-ave
          - apple,t8103-ave
          - apple,t8112-ave
          - apple,t8122-ave
          - apple,t8132-ave
          - apple,t6050-ave
          - apple,t8140-ave
          - apple,t8142-ave
  required:
    - compatible

properties:
  compatible: true

allOf:
  - properties:
      compatible:
        oneOf:
          - enum:
              - apple,t6000-ave
              - apple,t6041-ave
              - apple,t6050-ave
              - apple,t8112-ave
              - apple,t8140-ave
              - apple,t8142-ave
          - items:
              - enum:
                  - apple,t6020-ave
                  - apple,t6021-ave
                  - apple,t6022-ave
                  - apple,t6030-ave
                  - apple,t6031-ave
                  - apple,t6032-ave
                  - apple,t8103-ave
                  - apple,t8122-ave
                  - apple,t8132-ave
              - const: apple,ave

      reg:
        minItems: 3
        maxItems: 5
        description: Codec, mailbox, coprocessor and generation-specific auxiliary banks.

      reg-names:
        minItems: 3
        items:
          - const: codec
          - const: mailbox
          - const: coproc
          - enum: [pmgr, power-control]
          - enum: [fabric, pio]

      clocks:
        maxItems: 1

      interrupts:
        items:
          - description: Mailbox, raised when the firmware posts to a host ring
          - description: Codec interrupt handled by the firmware
          - description: Codec interrupt handled by the firmware
          - description: Codec interrupt handled by the firmware
          - description: Codec interrupt handled by the firmware

      power-domains:
        minItems: 1
        maxItems: 6

      power-domain-names:
        minItems: 5
        items:
          - const: dma
          - const: pipe4
          - const: pipe5
          - const: me0
          - const: me1
          - const: perf
            description: |
              A performance floor the encoder needs to run at full speed, held
              while the encoder is powered (for example the SoC rail floor of a
              PMC).

      iommus:
        minItems: 2
        maxItems: 4
        description:
          The encoder's stream on each of its DARTs. Where the motion-compensated
          temporal filter has its own stream (stream 12 on T8140), that stream is
          listed after the encoder's on each DART.

      memory-region:
        items:
          - description: Preloaded firmware text
          - description: Preloaded firmware data

    required:
      - compatible
      - reg
      - interrupts
      - power-domains
      - iommus

    allOf:
      - if:
          properties:
            compatible:
              contains:
                enum:
                  - apple,t6020-ave
                  - apple,t6021-ave
                  - apple,t6022-ave
        then:
          properties:
            reg:
              minItems: 5
        else:
          properties:
            power-domains:
              minItems: 5
          required:
            - reg-names
            - power-domain-names
      - if:
          properties:
            compatible:
              contains:
                enum:
                  - apple,t6041-ave
                  - apple,t6050-ave
                  - apple,t8132-ave
                  - apple,t8140-ave
                  - apple,t8142-ave
        then:
          properties:
            reg:
              maxItems: 3
            reg-names:
              maxItems: 3

    additionalProperties: false

unevaluatedProperties: false
```
