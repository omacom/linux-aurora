## Documentation/devicetree/bindings/phy/apple,t8152-usb2-phy.yaml
```yaml
# SPDX-License-Identifier: (GPL-2.0-only OR BSD-2-Clause)
%YAML 1.2
---
$id: http://devicetree.org/schemas/phy/apple,t8152-usb2-phy.yaml#
$schema: http://devicetree.org/meta-schemas/core.yaml#

title: Apple T8152 USB2 PHY

maintainers:
  - Joshua Warren <816217+joshuaswarren@users.noreply.github.com>

description: |
  The USB2 and eUSB2 register banks support a fixed host or fixed peripheral
  connection independently of the ATC USB3 and USB4 lanes. Firmware supplies
  device-specific calibration. Both independent USB power domains must stay
  active while the PHY runs.

$defs:
  tunable:
    $ref: /schemas/types.yaml#/definitions/uint32-matrix
    description: |
      Register offset, clear mask, and set value triples for the usb2 bank.
      The bootloader supplies these at boot; they are not part of the board file.
    items:
      items:
        - description: Aligned byte offset within the usb2 register bank
        - description: Bits to clear
        - description: Bits to set

properties:
  compatible:
    const: apple,t8152-usb2-phy

  reg:
    items:
      - description: USB2 PHY register bank
      - description: eUSB2 PHY register bank

  reg-names:
    items:
      - const: usb2
      - const: eusb2

  '#phy-cells':
    const: 0

  power-domains:
    items:
      - description: USB always-on domain
      - description: USB controller domain

  power-domain-names:
    items:
      - const: usb-aon
      - const: usb

  apple,tunable-usb2phy-dflt:
    $ref: '#/$defs/tunable'
    description: Default calibration, applied before the role calibration.

  apple,tunable-usb2phy-host:
    $ref: '#/$defs/tunable'
    description: Host calibration, applied before the PHY leaves reset.

  apple,tunable-usb2phy-dev:
    $ref: '#/$defs/tunable'
    description: |
      Device-mode calibration, applied before the PHY leaves reset in peripheral
      mode.

required:
  - compatible
  - reg
  - reg-names
  - '#phy-cells'
  - power-domains
  - power-domain-names

additionalProperties: false
```

## Documentation/devicetree/bindings/power/apple,pmc.yaml
```yaml
# SPDX-License-Identifier: (GPL-2.0-only OR BSD-2-Clause)
%YAML 1.2
---
$id: http://devicetree.org/schemas/power/apple,pmc.yaml#
$schema: http://devicetree.org/meta-schemas/core.yaml#

title: Apple SoC PMC voter interface

maintainers:
  - Diljit Singh <hey@djdev.me>

description: |
  The PMC arbitrates the performance states of shared rails, such as the
  DRAM controller and the SoC fabric, between voter agents. Each agent has a
  perf-state floor word with one 4-bit state per rail, and each rail has an
  interface enable word with one bit per agent. The PMC only honours an
  agent's floor on rails where its interface is enabled.

  Static agents are enabled for as long as the PMC is bound. A dynamic
  agent is a power domain: it is enabled after its parent domain powers on
  and disabled before its parent domain powers off. The host performance
  controller's agent is described by a child node that raises its floor
  while the CPU clusters or the GPU are busy.

properties:
  compatible:
    enum:
      - apple,t8132-pmc
      - apple,t8140-pmc

  reg:
    items:
      - description: Perf-state floor words of the voter agents
      - description: |
          Per-agent words holding the floor the PMC honours for each agent,
          and per-rail interface enable words

  reg-names:
    items:
      - const: voters
      - const: rails

  power-domains:
    maxItems: 1

  '#address-cells':
    const: 1

  '#size-cells':
    const: 0

  apple,static-voters:
    $ref: /schemas/types.yaml#/definitions/uint32-array
    description: Voter agents to enable on every rail.
    minItems: 1
    maxItems: 32
    items:
      maximum: 31

  '#cooling-cells':
    const: 2
    description: |
      The PMC can limit the DRAM controller (DCS) rail. Cooling state 0 leaves
      the rail to the agents' votes; each further state lowers the highest
      DCS state the PMC honours for them by one, down to the lowest state.

  apple,dcs-power-microwatt:
    description: |
      Power the system draws at each DCS performance state above what it
      draws at the lowest one, from the lowest state up, measured under a
      load whose speed follows the DCS state. With it, the DCS limit is a
      power actor that the power allocator thermal governor can drive.
    minItems: 2
    maxItems: 16

patternProperties:
  '^voter@[0-9a-f]+$':
    type: object
    description: A dynamic voter agent, provided as a power domain.
    additionalProperties: false

    properties:
      reg:
        maxItems: 1
        description: Voter agent index.

      label:
        description: Name of the power domain.

      '#power-domain-cells':
        const: 0

      power-domains:
        maxItems: 1
        description: Domain that must be powered while the agent is enabled.

    required:
      - reg
      - '#power-domain-cells'

  '^performance-controller@[0-9a-f]+$':
    type: object
    description: The host performance controller's voter agent.
    additionalProperties: false

    properties:
      compatible:
        enum:
          - apple,t8132-clpc
          - apple,t8140-clpc

      reg:
        maxItems: 1
        description: Voter agent index.

      apple,gpu-power-state:
        $ref: /schemas/types.yaml#/definitions/phandle
        description: PMGR power state of the GPU, used as a demand input.

    required:
      - compatible
      - reg

required:
  - compatible
  - reg
  - reg-names

additionalProperties: false

examples:
  - |
    soc {
        #address-cells = <2>;
        #size-cells = <2>;

        power-management@302800000 {
            compatible = "apple,t8140-pmc";
            reg = <0x3 0x02800000 0x0 0x10000>,
                  <0x3 0x028aa000 0x0 0x3000>;
            reg-names = "voters", "rails";
            #address-cells = <1>;
            #size-cells = <0>;
            #cooling-cells = <2>;
            apple,static-voters = <0 1 3>;
            apple,dcs-power-microwatt = <0 919000 1453000 2058000 2407000>;

            performance-controller@1 {
                compatible = "apple,t8140-clpc";
                reg = <1>;
            };

            voter@2 {
                reg = <2>;
                label = "gfx";
                #power-domain-cells = <0>;
            };
        };
    };
```

## Documentation/devicetree/bindings/power/apple,pmgr-pwrstate.yaml
```yaml
# SPDX-License-Identifier: (GPL-2.0-only OR BSD-2-Clause)
%YAML 1.2
---
$id: http://devicetree.org/schemas/power/apple,pmgr-pwrstate.yaml#
$schema: http://devicetree.org/meta-schemas/core.yaml#

title: Apple SoC PMGR Power States

maintainers:
  - Hector Martin <marcan@marcan.st>

allOf:
  - $ref: power-domain.yaml#

description: |
  Apple SoCs include PMGR blocks responsible for power management,
  which can control various clocks, resets, power states, and
  performance features. This binding describes the device power
  state registers, which control power states and resets.

  Each instance of a power controller within the PMGR syscon node
  represents a generic power domain provider, as documented in
  Documentation/devicetree/bindings/power/power-domain.yaml.
  The provider controls a single SoC block. The power hierarchy is
  represented via power-domains relationships between these nodes.

  See Documentation/devicetree/bindings/arm/apple/apple,pmgr.yaml
  for the top-level PMGR node documentation.

properties:
  compatible:
    oneOf:
      - items:
          - enum:
              # Do not add additional SoC to this list.
              - apple,s5l8960x-pmgr-pwrstate
              - apple,t7000-pmgr-pwrstate
              - apple,s8000-pmgr-pwrstate
              - apple,t8010-pmgr-pwrstate
              - apple,t8015-pmgr-pwrstate
              - apple,t8103-pmgr-pwrstate
              - apple,t8112-pmgr-pwrstate
              - apple,t6000-pmgr-pwrstate
          - const: apple,pmgr-pwrstate
      - items:
          - enum:
              - apple,t6020-pmgr-pwrstate
              - apple,t6030-pmgr-pwrstate
              - apple,t6031-pmgr-pwrstate
              - apple,t8122-pmgr-pwrstate
              - apple,t8132-pmgr-pwrstate
              - apple,t8140-pmgr-pwrstate
              - apple,t8142-pmgr-pwrstate
          - const: apple,t8103-pmgr-pwrstate

  reg:
    maxItems: 1

  "#power-domain-cells":
    const: 0

  "#reset-cells":
    const: 0

  power-domains:
    description:
      Reference to parent power domains. A domain may have multiple parents,
      and all will be powered up when it is powered.
    minItems: 1
    maxItems: 8 # Arbitrary, should be enough

  label:
    description:
      Specifies the name of the SoC domain being controlled. This is used to
      name the power/reset domains.

  apple,always-on:
    description:
      Forces this power domain to always be powered up.
    type: boolean

  apple,no-auto-pm:
    description: |
      Never enables automatic power management (auto-enable) for this
      domain: once powered up it stays at its requested state until
      Linux changes it. Required for a coprocessor CPU domain whose
      firmware is started cold by Linux and must not be clock or power
      gated behind its back, such as the T6030 external display
      coprocessors' CPU domains.
    type: boolean

  apple,firmware-owned:
    description:
      The boot loader hands over the coprocessor in this domain running, and its
      firmware owns the domain's power state; writing it faults. The OS keeps the
      domain on and never changes its power target, automatic gating or reset.
    type: boolean

  apple,inherited-on:
    description: |
      The boot loader leaves this domain powered, with the coprocessor it
      feeds running (the internal display chain of the T6030, T6031 and
      T8122 MacBook Pros: DISP_SYS, DISP_FE and DISP_CPU). The power state
      driver treats it as any domain found on; the display handoff requires
      the marker before it adds the PMP and sets apple,min-state on the
      chain, so the PMP cannot power the running display coprocessor down.
      Unlike apple,firmware-owned, the domain's register is still written.
    type: boolean

  apple,min-state:
    description:
      Specifies the minimum power state for auto-PM.
      0 = power gated, 4 = clock gated, 15 = on.
    $ref: /schemas/types.yaml#/definitions/uint32
    minimum: 0
    maximum: 15

  apple,force-disable:
    description:
      Forces this device to be disabled (bus access blocked) when the power
      domain is powered down.
    type: boolean

  apple,force-reset:
    description:
      Forces a reset/error recovery of the power control logic when the power
      domain is powered down.
    type: boolean

required:
  - compatible
  - reg
  - "#power-domain-cells"
  - "#reset-cells"
  - label

additionalProperties: false
```

## Documentation/devicetree/bindings/power/apple,t8140-pmp-report.yaml
```yaml
# SPDX-License-Identifier: (GPL-2.0-only OR BSD-2-Clause)
%YAML 1.2
---
$id: http://devicetree.org/schemas/power/apple,t8140-pmp-report.yaml#
$schema: http://devicetree.org/meta-schemas/core.yaml#

title: Apple T8132 and T8140 PMP report aperture

maintainers:
  - Ryan Murray <ryan@aurorasilicon.org>

description: |
  The PMP report aperture contains a read window and an update window.
  The PMP running bit qualifies the per-cluster fast-die effort. Lane 1
  tracks P-cluster load in Linux measurements. Lane 0 is assigned to the
  E cluster from the Apple device tree order and has not been observed
  changing. Only documented report entries may be read; the aperture is
  not a contiguous readable array of registers.

properties:
  compatible:
    enum:
      - apple,t8132-pmp-v2-report
      - apple,t8140-pmp-v2-report

  reg:
    maxItems: 1

  power-domains:
    maxItems: 1

  '#address-cells':
    const: 1

  '#size-cells':
    const: 0

  apple,pmp:
    $ref: /schemas/types.yaml#/definitions/phandle
    description:
      The PMP that publishes this report, on SoCs where the host starts the
      PMP after a display handoff.

patternProperties:
  '^report@[0-9a-f]+$':
    type: object
    description: |
      A device whose power state the host reports to the PMP, provided as a
      power domain. The host sets the device's request bit after its parent
      domain powers on and clears it before the parent powers off, and waits
      for the PMP to acknowledge while the PMP runs.
    additionalProperties: false

    properties:
      compatible:
        const: apple,t8140-pmp-v2-report-entry

      reg:
        maxItems: 1
        description: PMP soc-device index of the device.

      label:
        description: Name of the power domain.

      '#power-domain-cells':
        const: 0

      power-domains:
        maxItems: 1

      apple,always-on:
        type: boolean
        description: Report the device as on from probe.

      apple,no-ack:
        type: boolean
        description:
          The PMP does not acknowledge this entry's requests; the host sets
          and clears the request bit without waiting for an acknowledgement.

      apple,soc-device-record:
        type: boolean
        description:
          The request and acknowledge bits are indexed by the index of the
          PMP soc-device record (apple,tunable-soc-device on the PMP) that
          holds this entry's device ID, instead of by reg. Only valid on a
          report whose PMP the host starts.

    required:
      - compatible
      - reg
      - label
      - '#power-domain-cells'

required:
  - compatible
  - reg

additionalProperties: false

examples:
  - |
    soc {
        #address-cells = <2>;
        #size-cells = <2>;

        pmp-report@3003c0000 {
            compatible = "apple,t8140-pmp-v2-report";
            reg = <3 0x003c0000 0 0x14000>;
            #address-cells = <1>;
            #size-cells = <0>;

            report@9 {
                compatible = "apple,t8140-pmp-v2-report-entry";
                reg = <0x9>;
                label = "pmp-gfx";
                #power-domain-cells = <0>;
            };
        };
    };
```
