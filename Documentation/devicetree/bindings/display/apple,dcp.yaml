## Documentation/devicetree/bindings/pci/apple,pcie.yaml
```yaml
# SPDX-License-Identifier: (GPL-2.0-only OR BSD-2-Clause)
%YAML 1.2
---
$id: http://devicetree.org/schemas/pci/apple,pcie.yaml#
$schema: http://devicetree.org/meta-schemas/core.yaml#

title: Apple PCIe host controller

maintainers:
  - Mark Kettenis <kettenis@openbsd.org>

description: |
  The Apple PCIe host controller is a PCIe host controller with
  multiple root ports present in Apple ARM SoC platforms, including
  various iPhone and iPad devices and the "Apple Silicon" Macs.
  The controller incorporates Synopsys DesigWare PCIe logic to
  implements its root ports.  But the ATU found on most DesignWare
  PCIe host bridges is absent.

  On systems derived from T602x, the PHY registers are in a region
  separate from the port registers. In that case, there is one PHY
  register range per port register range.

  The PCIe-C variant connects a single root port to a USB4 router instead of
  a physical PCIe link. It has no external PHY or PERST# GPIO and follows the
  router's cable-controlled power lifetime.

  All root ports share a single ECAM space, but separate GPIOs are
  used to take the PCI devices on those ports out of reset.  Therefore
  the standard "reset-gpios" and "max-link-speed" properties appear on
  the child nodes that represent the PCI bridges that correspond to
  the individual root ports.

  MSIs are handled by the PCIe controller and translated into regular
  interrupts.  A range of 32 MSIs is provided.  These 32 MSIs can be
  distributed over the root ports as the OS sees fit by programming
  the PCIe controller's port registers.

$defs:
  tunable:
    $ref: /schemas/types.yaml#/definitions/uint32-matrix
    items:
      items:
        - description: Register offset
        - description: Mask of bits to clear
        - description: Bits to set
    description: Register initialization tuples for one controller region.

properties:
  compatible:
    oneOf:
      - items:
          - enum:
              - apple,t8103-pcie
              - apple,t8112-pcie
              - apple,t6000-pcie
          - const: apple,pcie
      - items:
          - const: apple,t8122-pcie
          - const: apple,t6020-pcie
      - const: apple,t6020-pcie
      - const: apple,t8140-pcie
      - const: apple,t8103-pciec
      - items:
          - const: apple,t8112-pciec
          - const: apple,t8103-pciec
      - items:
          - const: apple,t8152-pciec
          - const: apple,t8103-pciec
      - const: apple,t6000-pciec

  reg:
    minItems: 3
    maxItems: 10

  reg-names:
    minItems: 3
    maxItems: 10

  ranges:
    minItems: 2
    maxItems: 3

  interrupts:
    description:
      Interrupt specifiers, one for each root port.
    minItems: 1
    maxItems: 4

  msi-parent: true

  msi-ranges:
    maxItems: 1

  iommu-map: true
  iommu-map-mask: true

  power-domains:
    maxItems: 1

  resets:
    description:
      Reset of a tunneled (PCIe-C) controller and its DART, for controllers
      the kernel initializes itself.
    maxItems: 1

  dma-coherent: true

  apple,pciec-kernel-init:
    type: boolean
    description: The kernel initializes the tunneled controller from reset.

  apple,pciec-preinit-status:
    $ref: /schemas/types.yaml#/definitions/uint32
    description: |
      Handoff status of a tunneled (PCIe-C) controller. 1 means the boot
      loader left the port initialized; the driver then replays the
      initialization only if the port is not running.

  apple,tunable-rc:
    $ref: '#/$defs/tunable'
    description: Root-complex register initialization tuples.

  apple,tunable-fabric:
    $ref: '#/$defs/tunable'
    description: Initialization tuples for the fabric register region.

  apple,tunable-debug:
    $ref: '#/$defs/tunable'
    description: Initialization tuples for the debug register region.

  apple,tunable-oe-fabric:
    $ref: '#/$defs/tunable'
    description: Initialization tuples for the oe-fabric register region.

  apple,piodma:
    $ref: /schemas/types.yaml#/definitions/phandle
    description:
      T8140 PIODMA bootstrap engine used before native downstream ECAM access.

patternProperties:
  "^pci@":
    $ref: /schemas/pci/pci-bus.yaml#
    type: object
    description: A single PCI root port

    properties:
      reg:
        maxItems: 1

      pwren-gpios:
        description: Optional GPIO to power on the device
        maxItems: 1

      interrupt-controller: true

      apple,tunable:
        $ref: '#/$defs/tunable'
        description: Initialization tuples relative to this port's registers.

    required:
      - interrupt-controller
      - "#interrupt-cells"
      - interrupt-map-mask
      - interrupt-map

    unevaluatedProperties: false

required:
  - compatible
  - reg
  - reg-names
  - bus-range
  - interrupts
  - msi-controller
  - msi-parent
  - msi-ranges

unevaluatedProperties: false

allOf:
  - $ref: /schemas/pci/pci-host-bridge.yaml#
  - $ref: /schemas/interrupt-controller/msi-controller.yaml#
  - if:
      properties:
        compatible:
          contains:
            const: apple,t8140-pcie
    then:
      properties:
        apple,piodma: true
    else:
      properties:
        apple,piodma: false
  - if:
      properties:
        compatible:
          contains:
            const: apple,t8103-pcie
    then:
      properties:
        reg:
          maxItems: 5
        interrupts:
          maxItems: 3
  - if:
      properties:
        compatible:
          contains:
            const: apple,t6020-pcie
    then:
      properties:
        reg-names:
          minItems: 10
  - if:
      properties:
        compatible:
          contains:
            enum:
              - apple,t8103-pciec
              - apple,t6000-pciec
    then:
      properties:
        reg:
          minItems: 5
          maxItems: 7
        reg-names:
          oneOf:
            - items:
                - const: config
                - const: rc
                - const: port0
                - const: fabric
                - const: debug
            - items:
                - const: config
                - const: rc
                - const: port0
                - const: fabric
                - const: debug
                - const: ltssm
                - enum: [intr2axi, oe-fabric]
        interrupts:
          maxItems: 1
        ranges:
          minItems: 3
          maxItems: 3
    else:
      properties:
        resets: false
        apple,pciec-kernel-init: false
        apple,tunable-rc: false
        apple,tunable-fabric: false
        apple,tunable-debug: false
        apple,tunable-oe-fabric: false
        ranges:
          maxItems: 2
      allOf:
        - if:
            properties:
              compatible:
                contains:
                  const: apple,t8140-pcie
          then:
            properties:
              reg:
                minItems: 8
                maxItems: 8
              reg-names:
                items:
                  - const: config
                  - const: rc
                  - const: port0
                  - const: port1
                  - const: port2
                  - const: phy0
                  - const: phy1
                  - const: phy2
              interrupts:
                maxItems: 3
          else:
            properties:
              reg-names:
                minItems: 3
                items:
                  - const: config
                  - const: rc
                  - const: port0
                  - const: port1
                  - const: port2
                  - const: port3
                  - const: phy0
                  - const: phy1
                  - const: phy2
                  - const: phy3
      patternProperties:
        "^pci@":
          properties:
            apple,tunable: false
          required:
            - reset-gpios

examples:
  - |
    #include <dt-bindings/interrupt-controller/apple-aic.h>

    soc {
      #address-cells = <2>;
      #size-cells = <2>;

      pcie0: pcie@690000000 {
        compatible = "apple,t8103-pcie", "apple,pcie";
        device_type = "pci";

        reg = <0x6 0x90000000 0x0 0x1000000>,
              <0x6 0x80000000 0x0 0x100000>,
              <0x6 0x81000000 0x0 0x4000>,
              <0x6 0x82000000 0x0 0x4000>,
              <0x6 0x83000000 0x0 0x4000>;
        reg-names = "config", "rc", "port0", "port1", "port2";

        interrupt-parent = <&aic>;
        interrupts = <AIC_IRQ 695 IRQ_TYPE_LEVEL_HIGH>,
                     <AIC_IRQ 698 IRQ_TYPE_LEVEL_HIGH>,
                     <AIC_IRQ 701 IRQ_TYPE_LEVEL_HIGH>;

        msi-controller;
        msi-parent = <&pcie0>;
        msi-ranges = <&aic AIC_IRQ 704 IRQ_TYPE_EDGE_RISING 32>;

        iommu-map = <0x100 &dart0 1 1>,
                    <0x200 &dart1 1 1>,
                    <0x300 &dart2 1 1>;
        iommu-map-mask = <0xff00>;

        bus-range = <0 3>;
        #address-cells = <3>;
        #size-cells = <2>;
        ranges = <0x43000000 0x6 0xa0000000 0x6 0xa0000000 0x0 0x20000000>,
                 <0x02000000 0x0 0xc0000000 0x6 0xc0000000 0x0 0x40000000>;

        power-domains = <&ps_apcie_gp>;
        pinctrl-0 = <&pcie_pins>;
        pinctrl-names = "default";

        port00: pci@0,0 {
          device_type = "pci";
          reg = <0x0 0x0 0x0 0x0 0x0>;
          reset-gpios = <&pinctrl_ap 152 0>;

          #address-cells = <3>;
          #size-cells = <2>;
          ranges;

          interrupt-controller;
          #interrupt-cells = <1>;
          interrupt-map-mask = <0 0 0 7>;
          interrupt-map = <0 0 0 1 &port00 0 0 0 0>,
                          <0 0 0 2 &port00 0 0 0 1>,
                          <0 0 0 3 &port00 0 0 0 2>,
                          <0 0 0 4 &port00 0 0 0 3>;
        };

        port01: pci@1,0 {
          device_type = "pci";
          reg = <0x800 0x0 0x0 0x0 0x0>;
          reset-gpios = <&pinctrl_ap 153 0>;

          #address-cells = <3>;
          #size-cells = <2>;
          ranges;

          interrupt-controller;
          #interrupt-cells = <1>;
          interrupt-map-mask = <0 0 0 7>;
          interrupt-map = <0 0 0 1 &port01 0 0 0 0>,
                          <0 0 0 2 &port01 0 0 0 1>,
                          <0 0 0 3 &port01 0 0 0 2>,
                          <0 0 0 4 &port01 0 0 0 3>;
        };

        port02: pci@2,0 {
          device_type = "pci";
          reg = <0x1000 0x0 0x0 0x0 0x0>;
          reset-gpios = <&pinctrl_ap 33 0>;

          #address-cells = <3>;
          #size-cells = <2>;
          ranges;

          interrupt-controller;
          #interrupt-cells = <1>;
          interrupt-map-mask = <0 0 0 7>;
          interrupt-map = <0 0 0 1 &port02 0 0 0 0>,
                          <0 0 0 2 &port02 0 0 0 1>,
                          <0 0 0 3 &port02 0 0 0 2>,
                          <0 0 0 4 &port02 0 0 0 3>;
        };
      };
    };
```

## Documentation/devicetree/bindings/phy/apple,t8152-atcphy.yaml
```yaml
# SPDX-License-Identifier: (GPL-2.0-only OR BSD-2-Clause)
%YAML 1.2
---
$id: http://devicetree.org/schemas/phy/apple,t8152-atcphy.yaml#
$schema: http://devicetree.org/meta-schemas/core.yaml#

title: Apple T8152 Type-C PHY (SuperSpeed and USB4 lanes)

maintainers:
  - Joshua Warren <816217+joshuaswarren@users.noreply.github.com>

description: |
  The SuperSpeed / USB4 side of one ATC port of the Apple M6 (T8152). The USB2
  side of the same port is apple,t8152-usb2-phy. The PHY serves one transport
  at a time: USB3 for the dwc3 controller of the port, or CIO (USB4 /
  Thunderbolt) for the ACIO controller. Changing the transport shuts the PHY
  down and brings it up again.

  Firmware supplies the calibration. Every native tunable list of the ADT atc-phy
  node that the bring-up applies is passed as apple,tunable-<name>, where <name>
  is the ADT list name without the "tunable_" prefix, lower case, with "_"
  replaced by "-" (for example tunable_LN0_SMGR_REGS_CIO becomes
  apple,tunable-ln0-smgr-regs-cio). Offsets are relative to the register block
  the list belongs to (the driver knows the blocks). A list the ADT does not
  carry is left out. The two efuse lists apple,tunable-aciophy-cmn-dflt and
  apple,tunable-ciopll-core-dflt carry the factory calibration; a PHY without
  them is not calibrated.

$defs:
  tunable:
    $ref: /schemas/types.yaml#/definitions/uint32-matrix
    items:
      items:
        - description: Aligned byte offset within the register block of the list
        - description: Bits to clear
        - description: Bits to set

properties:
  compatible:
    const: apple,t8152-atcphy

  reg:
    items:
      - description: PHY core window (ADT atc-phy reg[2], 0x84000 bytes)

  reg-names:
    items:
      - const: core

  apple,dwc3:
    $ref: /schemas/types.yaml#/definitions/phandle
    description: |
      The dwc3 node of the port. The PHY uses its "pipe-handler" window (usb-drd
      reg[3], the PIPE mux it routes) and the PIPE_PHY_READY word (usb-drd reg[1],
      0x10000 above the "dwc3-core" window, inside the node's "dwc3-apple"
      window). They are not resources of this node because the dwc3 node already
      owns those ranges and the platform bus rejects equal or partly overlapping
      ranges.

  '#phy-cells':
    const: 1
    description: |
      0 selects the USB3 PHY (dwc3-apple, set_mode(HOST) routes the PIPE and
      brings the PHY up), 1 the CIO PHY (thunderbolt_apple, power_on/power_off).

  power-domains:
    minItems: 2
    maxItems: 2
    description:
      The USB AON domain (ps_atc*_usb_aon) and the ATC USB domain
      (psd_atc*_usb) of the port, in this order.

  power-domain-names:
    items:
      - const: usb-aon
      - const: usb

  orientation-switch:
    type: boolean
    description: Register a Type-C orientation switch (the connector node points at it).

  apple,cio-lanes:
    $ref: /schemas/types.yaml#/definitions/uint32
    enum: [1, 2, 3]
    default: 3
    description: Lane mask of the CIO bring-up, bit 0 lane 0 and bit 1 lane 1.

patternProperties:
  '^apple,tunable-[a-z0-9-]+$':
    $ref: '#/$defs/tunable'

required:
  - compatible
  - reg
  - reg-names
  - apple,dwc3
  - '#phy-cells'

additionalProperties: false

examples:
  - |
    soc {
        #address-cells = <2>;
        #size-cells = <2>;

        ps_atc2_usb_aon: power-controller-aon {
            #power-domain-cells = <0>;
        };

        psd_atc2_usb: power-controller-usb {
            #power-domain-cells = <0>;
        };

        usbdrd2: usb@382430000 {
            reg = <0x3 0x82430000 0x0 0xcd00>;
        };

        phy@383000000 {
            compatible = "apple,t8152-atcphy";
            reg = <0x3 0x83000000 0x0 0x84000>;
            reg-names = "core";
            apple,dwc3 = <&usbdrd2>;
            #phy-cells = <1>;
            power-domains = <&ps_atc2_usb_aon>, <&psd_atc2_usb>;
            power-domain-names = "usb-aon", "usb";
            orientation-switch;
        };
    };
```
