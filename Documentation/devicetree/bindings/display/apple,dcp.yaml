## drivers/gpu/drm/asahi/Kconfig
```kconfig
# SPDX-License-Identifier: GPL-2.0

config RUST_DRM_SCHED
	bool
	select DRM_SCHED

config RUST_DRM_GPUVM
	bool
	select DRM_GPUVM

config DRM_ASAHI
	tristate "Asahi (DRM support for Apple AGX GPUs)"
	depends on RUST
	depends on DRM=y
	depends on (ARM64 && ARCH_APPLE) || (COMPILE_TEST && !GENERIC_ATOMIC64)
	depends on MMU
	depends on IOMMU_SUPPORT
	depends on PAGE_SIZE_16KB
	select APPLE_PMP_REPORT
	select RUST_DRM_SCHED
	select RUST_DRM_GEM_SHMEM_HELPER
	select RUST_DRM_GPUVM
	select RUST_APPLE_RTKIT
	help
	  DRM driver for Apple AGX GPUs (G13x, found in the M1 SoC family)

config DRM_ASAHI_DEBUG_ALLOCATOR
	bool "Use debug allocator"
	depends on DRM_ASAHI
	help
	  Use an alternate, simpler allocator which significantly reduces
	  performance, but can help find firmware- or GPU-side memory safety
	  issues. However, it can also trigger firmware bugs more easily,
	  so expect GPU crashes.

	  Say N unless you are debugging firmware structures or porting to a
	  new firmware version.

config DRM_ASAHI_UAT_ADOPTION
	bool
	help
	  The firmware UAT handoff adoption shared by the G15 backend and the
	  T8122 runtime (g15/uat.rs, g15/regs.rs).

config DRM_ASAHI_M3_T8122
	bool "M3 MacBook Air GPU runtime (T8122, 14.8.3 firmware)"
	depends on DRM_ASAHI
	# The runtime adopts the firmware's UAT as the G15 backend does, without
	# needing that backend: M3 Pro/Max keep their own setting.
	# Its PMP votes call apple-pmp directly (m3_device.rs).
	depends on APPLE_PMP=y || (APPLE_PMP=m && DRM_ASAHI=m)
	select DRM_ASAHI_UAT_ADOPTION
	select APPLE_T8122_GPU_PMP_LINK
	select CRYPTO_LIB_SHA256
	default n
	help
	  Build the M3 runtime that starts the GPU of the M3 MacBook Air
	  (J613, J615) on the 14.8.3 GPU firmware the boot loader leaves
	  loaded. On the listed Air boards it starts after the boot loader
	  handed the GPU over and resource/firmware identity checks pass.
	  asahi.t8122_start=0 keeps startup disabled for recovery. Unknown
	  boards and firmware do not gain automatic admission. Other GPUs
	  are not affected.

config DRM_ASAHI_G15
	bool "Native G15 firmware backend (M3 Pro/Max)"
	depends on DRM_ASAHI
	depends on DRM_APPLE=y || (DRM_APPLE=m && DRM_ASAHI=m)
	select APPLE_T6030_GPU_PMP_LINK
	select APPLE_T6031_GPU_PMP_REPORT
	select CRYPTO_LIB_SHA256
	select DRM_ASAHI_UAT_ADOPTION
	default n
	help
	  Enable the native G15 backend for explicitly admitted M3 Pro/Max
	  firmware and boards. Other GPUs keep the maintained backend.
	  The firmware session is retained until reboot once started.
	  The native display driver must be built in, or both drivers must
	  be modules, so a modular display provider finishes initialization
	  before the GPU module can probe through its direct helper import.
```

## drivers/media/platform/apple/avd/Kconfig
```kconfig
# SPDX-License-Identifier: GPL-2.0-only

config VIDEO_APPLE_AVD
	tristate "Apple Silicon Video Decoding driver"
	depends on VIDEO_DEV
	depends on MEDIA_CONTROLLER
	depends on ARCH_APPLE || (COMPILE_TEST && 64BIT)
	depends on OF_ADDRESS
	depends on V4L_PLATFORM_DRIVERS
	select V4L2_MEM2MEM_DEV
	select VIDEOBUF2_DMA_CONTIG
	select V4L2_H264
	select V4L2_VP9
	help
	  Support the Apple Silicon stateless video decoder.

	  Build the decoder firmware from https://github.com/aurora-silicon/avd-fw
	  and install it under /lib/firmware/apple/. J700/T8140 uses the
	  avd-fw-v5-t0.bin image. Firmware is supplied separately from this driver.

config VIDEO_APPLE_AVD_KUNIT_TEST
	tristate "KUnit tests for the Apple video decoder" if !KUNIT_ALL_TESTS
	depends on VIDEO_APPLE_AVD && KUNIT
	default KUNIT_ALL_TESTS
	help
	  Build KUnit tests for the Apple video decoder. They exercise the
	  H.264 slice bounds, frame-slot ownership, and runtime power management,
	  including suspend gating and resubmission after firmware resume.

	  If unsure, say N.
```

## drivers/net/wireless/mediatek/mt7932/Kconfig
```kconfig
# SPDX-License-Identifier: GPL-2.0-only
config MT7932_FULLMAC
	tristate "MediaTek MT7932 Wi-Fi on the Apple MacBook Neo (J700)"
	depends on PCI && OF && ARM64 && IOMMU_DMA
	depends on PCIE_APPLE_PIODMA_DIAG && CFG80211
	select FW_LOADER
	select CRYPTO
	select CRYPTO_HMAC
	select CRYPTO_SHA1
	select CRYPTO_LIB_SHA256
	help
	  Support for the Wi-Fi function of the MediaTek MT7932 radio in the
	  Apple MacBook Neo (J700). The firmware runs association and the
	  WPA2-PSK or WPA3-SAE handshake; the driver is a cfg80211 station on
	  2.4 GHz and the 5 GHz UNII-1, -2, -2e and -3 channels that the regulatory
	  domain permits. Radar (DFS) channels are scanned passively; an AP heard
	  there during the connect attempt may be joined, and is left when it
	  announces a channel switch.
	  Other MediaTek devices and other machines are not matched.

	  The driver needs the original firmware, the unit's own calibration
	  and the country policy packages under mediatek/mt7932/, besides the
	  cfg80211 regulatory database. The device is probed before the root
	  filesystem is mounted, so say M unless those files are in the
	  initramfs.

	  Once the device has been given DMA addresses, the module cannot be
	  unloaded. A function that fails to initialize and cannot be reset
	  stays bound and keeps its DMA memory.

config MT7932_RF_KUNIT_TEST
	bool "KUnit tests for MT7932 terminal RF failure" if !KUNIT_ALL_TESTS
	depends on KUNIT=y && MT7932_FULLMAC
	default KUNIT_ALL_TESTS
	help
	  Exercise the driver's terminal calibration failure and startup
	  admission paths with synthetic devices, without radio hardware.
	  Check association wakeups, retained peer ownership and refusal to
	  reopen RF admission after a terminal calibration error.

config MT7932_KUNIT_TEST
	bool "KUnit tests for MT7932 firmware input validation" if !KUNIT_ALL_TESTS
	depends on KUNIT=y && MT7932_FULLMAC
	default KUNIT_ALL_TESTS
	help
	  Exercise the validation of what the firmware and the device hand
	  to the driver, with synthetic, truncated and corrupted input and
	  without radio hardware: receive descriptors, including frames the
	  hardware did not decrypt, command replies, regulatory snapshots
	  and country power packages. Also check connection admission, SAE
	  request encoding, WPA passphrase derivation and channel switch
	  announcements.
```

## drivers/phy/apple/Kconfig
```kconfig
# SPDX-License-Identifier: GPL-2.0 OR BSD-2-Clause
config PHY_APPLE_ATC
	tristate "Apple Type-C PHY"
	depends on (ARM64 && ARCH_APPLE) || (COMPILE_TEST && !GENERIC_ATOMIC64)
	depends on TYPEC
	depends on USB || !USB
	select GENERIC_PHY
	select APPLE_TUNABLE
	help
	  Enable this to add support for the Apple Type-C PHY found in
	  Apple Silicon M-series SoCs. This PHY supports USB2,
	  USB3, USB4, Thunderbolt, and DisplayPort.

	  If M is selected the module will be called 'phy-apple-atc'.

config PHY_APPLE_ATC_KUNIT_TEST
	bool "KUnit tests for the Apple Type-C PHY" if !KUNIT_ALL_TESTS
	depends on PHY_APPLE_ATC && KUNIT
	depends on PHY_APPLE_ATC=m || KUNIT=y
	default KUNIT_ALL_TESTS
	help
	  Build the KUnit tests for the Type-C mux decisions of the Apple
	  Type-C PHY driver into the driver. They check how Type-C states
	  map to PHY modes, which mux updates may skip the lane and PIPE
	  work, and that a port behind a fixed hub has the controller's
	  SuperSpeed port off while its PIPE moves. The tests need no
	  hardware and run when the driver is loaded.

	  Also check tunnel qualification, T8122 link rates, drive presets
	  and lane mapping using fixtures without PHY hardware.

	  If unsure, say N.

config PHY_APPLE_DPTX
	tristate "Apple DPTX PHY"
	depends on ARCH_APPLE || COMPILE_TEST
	select GENERIC_PHY
	help
	  Enable this to add support for the Apple DPTX PHY found on Apple SoCs
	  such as the M2.
	  This driver provides support for DisplayPort and is used on the
	  Mac mini (M2 and M2 Pro, 2023).

config PHY_APPLE_T8152_USB2
	tristate "Apple T8152 fixed-host USB2 PHY"
	default ARCH_APPLE
	depends on ARCH_APPLE || COMPILE_TEST
	depends on PM
	select GENERIC_PHY
	select APPLE_TUNABLE
	help
	  Enable the USB2-only PHY for fixed host ports on Apple T8152.
	  This does not configure the USB3 or USB4 lanes.
```
