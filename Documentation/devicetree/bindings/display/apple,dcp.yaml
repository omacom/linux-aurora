## Documentation/devicetree/bindings/soc/apple/apple,t8140-aop.yaml
```yaml
# SPDX-License-Identifier: (GPL-2.0-only OR BSD-2-Clause)
%YAML 1.2
---
$id: http://devicetree.org/schemas/soc/apple/apple,t8140-aop.yaml#
$schema: http://devicetree.org/meta-schemas/core.yaml#

title: Apple T8140 Always-On Processor

maintainers:
  - Ryan Murray <ryan@aurorasilicon.org>

description:
  The Always-On Processor provides audio and sensor services through firmware
  loaded by the bootloader. On T8140 the application processor uses a primary
  mailbox and a separate setup-port mailbox; on T8152 the setup port belongs to
  the secure world and only the primary mailbox exists. Each mailbox consumer
  has its own DMA allocation window in the inherited AOP DART mappings.

properties:
  compatible:
    enum:
      - apple,t8140-aop
      - apple,t8152-aop

  reg:
    items:
      - description: AOP register and boot-argument window
      - description: ASC wrapper and processor control registers

  reg-names:
    items:
      - const: mmio
      - const: asc

  mboxes:
    minItems: 1
    items:
      - description: Primary firmware transport
      - description: Firmware setup-port transport (T8140 only)

  mbox-names:
    minItems: 1
    items:
      - const: mbox
      - const: setup

  iommus:
    maxItems: 1

  apple,dma-range:
    $ref: /schemas/types.yaml#/definitions/uint64-array
    minItems: 2
    maxItems: 2
    description:
      Host DMA allocation window as a base and nonzero size. The window must
      occupy root slots available to the host on this AOP DART stream.

  power-domains:
    maxItems: 1

  als:
    type: object
    $ref: /schemas/iio/light/apple,t8140-aop-als.yaml#

  audio:
    type: object
    $ref: /schemas/sound/apple,t8140-aop-audio.yaml#

allOf:
  - if:
      properties:
        compatible:
          const: apple,t8140-aop
    then:
      properties:
        mboxes:
          minItems: 2
        mbox-names:
          minItems: 2
    else:
      properties:
        mboxes:
          maxItems: 1
        mbox-names:
          maxItems: 1

required:
  - compatible
  - reg
  - reg-names
  - mboxes
  - mbox-names
  - iommus
  - apple,dma-range
  - power-domains

additionalProperties: false
```

## Documentation/devicetree/bindings/sound/apple,t8140-aop-audio.yaml
```yaml
# SPDX-License-Identifier: (GPL-2.0-only OR BSD-2-Clause)
%YAML 1.2
---
$id: http://devicetree.org/schemas/sound/apple,t8140-aop-audio.yaml#
$schema: http://devicetree.org/meta-schemas/core.yaml#

title: Apple T8140 and T8152 AOP audio

maintainers:
  - Ryan Murray <ryan@aurorasilicon.org>

description: |
  The Always-On Processor on Apple T8140 SoCs owns the machine's low-power
  audio paths. This node is a child of the AOP node and describes the DMA
  channels and power domains the host needs in order to drive them, namely
  the internal speaker, the 3.5 mm headset jack in both directions, a serial
  monitor tap on the speaker output, and the high-quality microphone array.

  The low-power microphone uses a shared ring on this node's DART stream.
  The remaining audio data moves over the named ADMAC channels while its AOP
  service is active. The parent AOP binding describes the firmware transport.

  On T8152 (Mac mini, J873) the AOP offers only the speaker, jack output and
  jack input services; the low-power and array microphones and the speaker tap
  answer with kIOReturnNoDevice. The serializers and the audio fabric are
  powered by the firmware, so the node has no power domains and no DART stream
  of its own, and the sound card is described by a separate machine node.

properties:
  compatible:
    enum:
      - apple,t8140-aop-audio
      - apple,t8152-aop-audio

  dmas:
    minItems: 4
    items:
      - description: Internal speaker output
      - description: Headset jack output
      - description: Headset microphone input
      - description: Speaker output monitor input
      - description: High-quality microphone array input (T8140 only)

  dma-names:
    minItems: 4
    items:
      - const: spkr
      - const: cout
      - const: cin
      - const: spkr-tap
      - const: hpai

  power-domains:
    items:
      - description: LEAP speaker transmit channel
      - description: LEAP serializer
      - description: Headset serializer
      - description: Speaker monitor serializer
      - description: LEAP microphone receive channel

  power-domain-names:
    items:
      - const: tx0
      - const: mca
      - const: mca1
      - const: mca0
      - const: rx0

  iommus:
    maxItems: 1

  apple,dma-range:
    $ref: /schemas/types.yaml#/definitions/uint64-array
    minItems: 2
    maxItems: 2
    description: |
      IOVA window the AOP may use for this device's audio buffers, expressed
      as a base followed by its size.

  "#sound-dai-cells":
    const: 1
    description:
      AOP audio DAI identifier. The J700 headset link uses 0 and its speaker
      link uses 4.

  apple,chassis-name:
    $ref: /schemas/types.yaml#/definitions/string
    description:
      Chassis identifier used to name the sound card, matching the
      apple,aop-audio convention.

  apple,machine-kind:
    $ref: /schemas/types.yaml#/definitions/string
    description:
      Human-readable machine name used in the sound card's description.

required:
  - compatible
  - dmas
  - dma-names
  - "#sound-dai-cells"

allOf:
  - $ref: dai-common.yaml#
  - if:
      properties:
        compatible:
          const: apple,t8140-aop-audio
    then:
      properties:
        dmas:
          minItems: 5
        dma-names:
          minItems: 5
      required:
        - power-domains
        - power-domain-names
        - iommus
        - apple,dma-range
        - apple,chassis-name
        - apple,machine-kind
    else:
      properties:
        dmas:
          maxItems: 4
        dma-names:
          maxItems: 4
        power-domains: false
        power-domain-names: false
        iommus: false
        apple,dma-range: false

unevaluatedProperties: false

examples:
  - |
    aop {
        audio {
            compatible = "apple,t8140-aop-audio";
            iommus = <&aop_dart 9>;
            apple,dma-range = <0x100 0x40000000 0x0 0xffff0000>;
            dmas = <&admac_leap_ns 0>, <&admac_base_ns 4>,
                   <&admac_base_ns 5>, <&admac_base_ns 3>,
                   <&admac_leap_s 1>;
            dma-names = "spkr", "cout", "cin", "spkr-tap", "hpai";
            power-domains = <&ps_audio_leap_tx0>, <&ps_audio_leap_mca>,
                            <&ps_audio_mca1_m>, <&ps_audio_mca0_m>,
                            <&ps_audio_leap_rx0>;
            power-domain-names = "tx0", "mca", "mca1", "mca0", "rx0";
            #sound-dai-cells = <1>;
            apple,chassis-name = "J700";
            apple,machine-kind = "MacBook Neo";
        };
    };
```

## Documentation/devicetree/bindings/spi/apple,qspi.yaml
```yaml
# SPDX-License-Identifier: (GPL-2.0-only OR BSD-2-Clause)
%YAML 1.2
---
$id: http://devicetree.org/schemas/spi/apple,qspi.yaml#
$schema: http://devicetree.org/meta-schemas/core.yaml#

title: Apple ARM SoC QSPIMC controller

maintainers:
  - Ryan Murray <ryan@aurorasilicon.org>

description: |
  Apple QSPIMC is a SPI-memory-only controller with a packed command FIFO.
  It is distinct from the ordinary Apple SPIMC controller despite serving a
  similar set of SPI NOR devices.

allOf:
  - $ref: spi-controller.yaml#

properties:
  compatible:
    oneOf:
      - const: apple,t8140-qspi
      - items:
          - const: apple,t8152-qspi
          - const: apple,t8140-qspi

  reg:
    maxItems: 1

  clocks:
    maxItems: 1

  interrupts:
    maxItems: 1

  power-domains:
    maxItems: 1

required:
  - compatible
  - reg
  - clocks
  - interrupts

unevaluatedProperties: false

examples:
  - |
    #include <dt-bindings/interrupt-controller/apple-aic.h>
    #include <dt-bindings/interrupt-controller/irq.h>

    soc {
      #address-cells = <2>;
      #size-cells = <2>;

      spi@385110000 {
        compatible = "apple,t8140-qspi";
        reg = <0x3 0x85110000 0x0 0x4800>;
        interrupt-parent = <&aic>;
        interrupts = <AIC_IRQ 1106 IRQ_TYPE_LEVEL_HIGH>;
        clocks = <&clk_200m>;
        #address-cells = <1>;
        #size-cells = <0>;
      };
    };
```

## Documentation/devicetree/bindings/usb/apple,t8152-dwc3.yaml
```yaml
# SPDX-License-Identifier: (GPL-2.0-only OR BSD-2-Clause)
%YAML 1.2
---
$id: http://devicetree.org/schemas/usb/apple,t8152-dwc3.yaml#
$schema: http://devicetree.org/meta-schemas/core.yaml#

title: Apple T8152 USB2-only controller

maintainers:
  - Joshua Warren <816217+joshuaswarren@users.noreply.github.com>

description: |
  This USB2-only profile starts a fixed role at probe, with or without a
  physical hub child node: host mode, or — for a debug-cable port — fixed
  peripheral (gadget) mode selected with dr_mode. The controller never
  switches roles at runtime.
  The dr_mode and maximum-speed properties must select host or peripheral and
  high-speed.
  Firmware supplies device-specific calibration records as offset, clear-mask,
  set-value triples. Offsets are relative to each native register bank, not
  the combined Linux window. The core window ends at 0xcd00. The Apple window
  starts at 0xcd00 and covers the debug, configuration, and link banks through
  0x11800. These windows must not overlap.

allOf:
  - $ref: snps,dwc3-common.yaml#

properties:
  compatible:
    const: apple,t8152-dwc3

  reg:
    items:
      - description: DWC3 core, offsets 0 through 0xccff
      - description: Apple registers, offsets 0xcd00 through 0x117ff
      - description: PIPE handler (native register bank 3)
      - description: Power control (native register bank 5)
      - description: Bulk fabric (native register bank 6)
      - description: AUSBC debug (native register bank 8)

  reg-names:
    items:
      - const: dwc3-core
      - const: dwc3-apple
      - const: pipe-handler
      - const: pwr-ctrl
      - const: bulk-fabric
      - const: ausbc-debug

  interrupts:
    maxItems: 1

  iommus:
    minItems: 4
    maxItems: 4

  power-domains:
    maxItems: 1

  phys:
    maxItems: 1

  phy-names:
    items:
      - const: usb2-phy

  dr_mode:
    enum: [ host, peripheral ]

  maximum-speed:
    const: high-speed

  '#address-cells':
    const: 1

  '#size-cells':
    const: 0


patternProperties:
  '^hub@[1-9a-f][0-9a-f]?$':
    $ref: /schemas/usb/usb-device.yaml#
  '^apple,tunable-(bulk-fabric-default|pipe-handler-default|pipe-handler-host|pwr-ctrl-default|drd-usb31-gbl-default|drd-usb31-gbl-host|drd-cio-regs-default|drd-usb31-dbg-default|drd-usb31-cfg-host|link-regs-default|ausbc-debug-default)$':
    $ref: /schemas/types.yaml#/definitions/uint32-array
    description: Native bank-relative offset, clear-mask, set-value triples.

required:
  - compatible
  - reg
  - reg-names
  - interrupts
  - iommus
  - power-domains
  - phys
  - phy-names
  - dr_mode
  - maximum-speed

unevaluatedProperties: false
```

## drivers/gpu/drm/apple/Kconfig
```kconfig
# SPDX-License-Identifier: GPL-2.0-only OR MIT
config DRM_APPLE
	tristate "DRM Support for Apple display controllers"
	depends on DRM && OF && ARM64
	depends on ARCH_APPLE || COMPILE_TEST
	depends on APPLE_RTKIT
	depends on TYPEC || !TYPEC
	depends on OF_ADDRESS
	select APPLE_PMP_REPORT
	select OF_DYNAMIC
	select DRM_CLIENT_SELECTION
	select DRM_KMS_HELPER
	select DRM_KMS_DMA_HELPER
	select DRM_GEM_SHMEM_HELPER
	select DRM_GEM_DMA_HELPER
	select VIDEOMODE_HELPERS
	depends on BACKLIGHT_CLASS_DEVICE
	depends on INPUT
	select MULTIPLEXER
	select DRM_APPLE_FABRIC_CORE
	help
	  Say Y if you have an Apple Silicon chipset. This includes the
	  Type-C display fabric and Thunderbolt display routing.

config DRM_APPLE_AUDIO
	bool "DisplayPort/HDMI Audio support"
	default y
	depends on DRM_APPLE
	depends on SND
	select SND_PCM
	select SND_DMAENGINE_PCM

config DRM_APPLE_DCP_T6030_AUDIO
	bool "HDMI audio through the T6030 external display processor"
	default y
	depends on DRM_APPLE_AUDIO
	help
	  DP/HDMI audio of the external display processors of the M3 Pro
	  (T6030, MacBook Pro J514S/J516S built-in HDMI port), whose DCP
	  firmware 14.7 external role takes 32-byte audio link data and the
	  native driver's link lifecycle. The audio service of every other
	  DCP is driven unchanged. Say N to build the audio and element
	  parser code exactly as before.

config DRM_APPLE_DEBUG
	bool "Enable additional driver debugging"
	depends on DRM_APPLE
	depends on EXPERT # only for developers

config DRM_APPLE_KUNIT_TEST
	tristate "KUnit tests for Apple display controller" if !KUNIT_ALL_TESTS
	depends on KUNIT
	depends on DRM_APPLE || !DRM_APPLE
	select DRM_KUNIT_TEST_HELPERS if DRM_APPLE
	default KUNIT_ALL_TESTS
	help
	  Build tests for the Apple display driver's AFK ring parser and
	  backlight policy (takeover, DPMS, suspend, fades and present
	  completion).
	  The tests cover the header strides used by older firmware and
	  larger rings, as well as malformed ring size combinations.
	  This option is intended for developer test kernels.
	  Also test the Type-C modeset, hotplug and service ownership state,
	  the system resume of a CRTC whose mode is no longer admissible,
	  when an external display is ready to be reported to userspace, and
	  which display processors must have started before the boot
	  framebuffer is taken over.
	  The AFK service lifetime test uses the display driver and is built
	  with it. When the driver is a module, these tests can only be
	  built as modules too. The standalone modeset state test can still
	  be built without the driver.

config DRM_APPLE_PARSER_KUNIT_TEST
	bool "KUnit tests for Apple firmware message parsers" if !KUNIT_ALL_TESTS
	depends on DRM_APPLE && KUNIT=y
	default KUNIT_ALL_TESTS
	help
	  Build tests for AFKv2 lengths, DMA ownership and reply correlation,
	  legacy EPIC replies, and H17P IOMFB callback envelopes and sizes.
	  The tests use allocated buffers and fake devices and do not require
	  an Apple display controller or any firmware.

config DRM_APPLE_DISPLAY_KUNIT_TEST
	bool "KUnit tests for Apple display mode probing" if !KUNIT_ALL_TESTS
	depends on KUNIT && DRM_APPLE
	select DRM_KUNIT_TEST_HELPERS
	select DRM_CLIENT
	default KUNIT_ALL_TESTS
	help
	  Test the production timing parser and display reply bounds without
	  Apple display hardware, including incomplete records and stable
	  preferred mode selection. Exercise mode list replacement and
	  catalog admission for each display attachment. Check connector
	  status updates before hotplug notifications and same-state retrains.
	  Check which 14.x board record an internal display gets on which
	  machine, and which DCP firmware image each record admits.
```
