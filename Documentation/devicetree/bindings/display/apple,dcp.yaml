## Documentation/devicetree/bindings/power/apple,t8152-psd.yaml
```yaml
# SPDX-License-Identifier: (GPL-2.0-only OR BSD-2-Clause)
%YAML 1.2
---
$id: http://devicetree.org/schemas/power/apple,t8152-psd.yaml#
$schema: http://devicetree.org/meta-schemas/core.yaml#

title: Apple T8152 PSD service slot power domain

maintainers:
  - Joshua Warren <816217+joshuaswarren@users.noreply.github.com>

allOf:
  - $ref: power-domain.yaml#

description: |
  The T8152 (M6) power state director (PSD) gates some blocks, among them the
  USB controllers and their DARTs, behind a per-port service slot. Each
  slot has a 0x100 byte register window at the PSD base plus (slot << 8) with
  the status (0x80), request (0x90), diagnostic (0xa0) and valid (0xbc)
  registers. A consumer must power the parent PMGR domains of the block
  first, then request state 0 (running) and wait for the acknowledge. This
  node models that as a power domain: the PMGR domains are its parents
  (power-domains), powering it on writes the request. Power-off requests
  state 6 (off).

  A "apple,t8152-psd-group" node covers several slots that are brought up
  together: one reg window per slot, requested in reg order with the active
  state given by apple,psd-states, and put back to state 6 in reverse order.

properties:
  compatible:
    enum:
      - apple,t8152-psd
      - apple,t8152-psd-group

  reg:
    minItems: 1
    maxItems: 3

  "#power-domain-cells":
    const: 0

  power-domains:
    description:
      Parent PMGR power domains, powered before the slot request. Absent when
      the block has no PMGR power state.
    minItems: 1
    maxItems: 4

  label:
    description: Name of the power domain.

  apple,psd-states:
    $ref: /schemas/types.yaml#/definitions/uint32-array
    minItems: 1
    maxItems: 3
    description:
      Active PSD state requested for each reg window, in reg order (default
      0, running). Each value is 0 to 5.

  apple,psd-timeout-ms:
    description: Acknowledge timeout in milliseconds (default 1000).

required:
  - compatible
  - reg
  - "#power-domain-cells"

unevaluatedProperties: false

examples:
  - |
    soc {
      #address-cells = <2>;
      #size-cells = <2>;

      ps_usb_aon: power-controller-aon {
        #power-domain-cells = <0>;
      };

      ps_usb: power-controller-usb {
        #power-domain-cells = <0>;
      };

      power-controller@1000 {
        compatible = "apple,t8152-psd";
        reg = <0x0 0x1000 0x0 0x100>;
        #power-domain-cells = <0>;
        power-domains = <&ps_usb_aon>, <&ps_usb>;
        label = "psd_example";
      };
    };
  - |
    soc {
      #address-cells = <2>;
      #size-cells = <2>;

      power-controller@2000 {
        compatible = "apple,t8152-psd-group";
        reg = <0x0 0x2000 0x0 0x100>,
              <0x0 0x2100 0x0 0x100>,
              <0x0 0x2200 0x0 0x100>;
        apple,psd-states = <0 2 2>;
        #power-domain-cells = <0>;
        label = "psd_group_example";
      };
    };
```

## Documentation/devicetree/bindings/reset/apple,t8103-cio-reset.yaml
```yaml
# SPDX-License-Identifier: (GPL-2.0-only OR BSD-2-Clause)
%YAML 1.2
---
$id: http://devicetree.org/schemas/reset/apple,t8103-cio-reset.yaml#
$schema: http://devicetree.org/meta-schemas/core.yaml#

title: Apple SoC CIO (USB4/Thunderbolt) block reset controller

maintainers:
  - Sven Peter <sven@kernel.org>

description: |
  The CIO (Converged I/O) blocks on Apple Silicon SoCs have a reset
  inside the power manager (PMGR) that has to be deasserted before
  their co-processor can be booted. On t8103 each port comes with a
  dedicated register page, represented as a standalone node. On t600x a
  single register shared by all ports of a die with one request bit per
  port is used instead. Since this register is located in the middle of
  the PMGR MMIO region it is represented as a sub-node of the PMGR
  syscon with reg used as an offset into it.

  On t8142, a standalone register page contains a shared request register
  with alternating request and busy bits for four ports.

  On t8152 the request and done registers are two adjacent words in the PMGR
  region and, as on t600x, are a sub-node of the PMGR syscon; reg is the offset
  of the request register and the reset id is the CIO cluster index.

  On the other SoCs the reset id is the CIO port index on the die.

properties:
  compatible:
    oneOf:
      - enum:
          - apple,t8103-cio-reset
          - apple,t8142-cio-reset
          - apple,t6000-cio-reset
          - apple,t8152-cio-reset
      - items:
          - const: apple,t8112-cio-reset
          - const: apple,t8103-cio-reset
      - items:
          - const: apple,t6020-cio-reset
          - const: apple,t6000-cio-reset

  reg:
    maxItems: 1

  '#reset-cells':
    const: 1

required:
  - compatible
  - reg
  - '#reset-cells'

additionalProperties: false

examples:
  - |
    soc {
        #address-cells = <2>;
        #size-cells = <2>;

        reset-controller@23b784000 {
            compatible = "apple,t8103-cio-reset";
            reg = <0x2 0x3b784000 0x0 0x8000>;
            #reset-cells = <1>;
        };
    };
```

## Documentation/devicetree/bindings/rtc/apple,smc-rtc.yaml
```yaml
# SPDX-License-Identifier: (GPL-2.0-only OR BSD-2-Clause)
%YAML 1.2
---
$id: http://devicetree.org/schemas/rtc/apple,smc-rtc.yaml#
$schema: http://devicetree.org/meta-schemas/core.yaml#

title: Apple SMC RTC

description:
  Apple Silicon Macs (M1, etc.) have an RTC that is part of the PMU IC,
  but most of the PMU functionality is abstracted out by the SMC.
  An additional RTC offset stored inside NVMEM is required to compute
  the current date/time.

maintainers:
  - Sven Peter <sven@kernel.org>

properties:
  compatible:
    const: apple,smc-rtc

  nvmem-cells:
    minItems: 1
    items:
      - description:
          RTC offset. By default a 48bit value, specified in 32768 (2^15) Hz
          clock ticks. With apple,rtc-offset-seconds, a 64bit little-endian
          count of whole seconds.
      - description:
          PMU alarm control byte, with the alarm enable, the monitor bit and
          the latched alarm event.
      - description:
          PMU alarm compare value, a 32-bit count of whole seconds of the RTC
          counter without the offset.
      - description: PMU alarm mask byte.
      - description:
          PMU alarm event byte, write 1 to clear. Maverick PMUs, such as the
          M1 Pro's and the M2 Pro's, latch a fired alarm here as well as in the
          control byte, and keep the alarm interrupt silent until it is
          cleared.

  nvmem-cell-names:
    oneOf:
      - items:
          - const: rtc_offset
      - items:
          - const: rtc_offset
          - const: rtc_ctrl
          - const: rtc_alarm
          - const: rtc_alarm_mask
      - items:
          - const: rtc_offset
          - const: rtc_ctrl
          - const: rtc_alarm
          - const: rtc_alarm_mask
          - const: rtc_alarm_event

  interrupts:
    maxItems: 1
    description:
      The PMU's RTC alarm interrupt. Only used with the alarm cells.

  wakeup-source: true

  apple,rtc-offset-seconds:
    type: boolean
    description:
      The RTC offset cell holds whole seconds rather than 32768 Hz ticks. The
      current time is the SMC RTC counter's integer seconds plus the offset.
      Used where the system firmware keeps the offset in a PMU scratchpad
      register in this format, such as on the t8140 (A18 Pro).

required:
  - compatible
  - nvmem-cells
  - nvmem-cell-names

additionalProperties: false
```

## Documentation/devicetree/bindings/soc/apple/apple,dockchannel.yaml
```yaml
# SPDX-License-Identifier: (GPL-2.0-only OR BSD-2-Clause)
%YAML 1.2
---
$id: http://devicetree.org/schemas/soc/apple/apple,dockchannel.yaml#
$schema: http://devicetree.org/meta-schemas/core.yaml#

title: Apple DockChannel FIFO bus

maintainers:
  - Ryan Murray <ryan@aurorasilicon.org>

description:
  DockChannel is a set of byte FIFOs between the application processor and a
  coprocessor. Each channel has a host side and a remote side, each with a
  configuration window and a data window, and the channels of one block
  share an interrupt window whose interrupts signal FIFO threshold events.
  This node maps the interrupt window, translates the channel register
  windows for its children and is their interrupt controller. Each child
  describes one function carried over a channel pair.

properties:
  compatible:
    items:
      - enum:
          - apple,t6020-dockchannel
          - apple,t6030-dockchannel
          - apple,t6031-dockchannel
          - apple,t6050-dockchannel
          - apple,t8112-dockchannel
          - apple,t8122-dockchannel
          - apple,t8140-dockchannel
          - apple,t8142-dockchannel
      - const: apple,dockchannel

  reg:
    maxItems: 1

  reg-names:
    const: irq

  interrupts:
    maxItems: 1

  ranges: true

  nonposted-mmio: true

  '#address-cells':
    const: 1

  '#size-cells':
    const: 1

  interrupt-controller: true

  '#interrupt-cells':
    const: 2
    description:
      The first cell is the FIFO interrupt number within the block and the
      second cell the trigger type.

patternProperties:
  '^input@[0-9a-f]+$':
    type: object
    $ref: /schemas/input/apple,dockchannel-hid.yaml#
    description: A DockChannel HID transport.

required:
  - compatible
  - reg
  - reg-names
  - interrupts
  - ranges
  - '#address-cells'
  - '#size-cells'
  - interrupt-controller
  - '#interrupt-cells'

additionalProperties: false

examples:
  - |
    #include <dt-bindings/interrupt-controller/apple-aic.h>
    #include <dt-bindings/interrupt-controller/irq.h>

    soc {
        #address-cells = <2>;
        #size-cells = <2>;

        mtp_dockchannel: fifo@314b14000 {
            compatible = "apple,t8140-dockchannel", "apple,dockchannel";
            reg = <0x3 0x14b14000 0x0 0x4000>;
            reg-names = "irq";
            interrupts = <AIC_IRQ 1137 IRQ_TYPE_LEVEL_HIGH>;
            ranges = <0x0 0x3 0x14b28000 0x20000>;
            nonposted-mmio;
            #address-cells = <1>;
            #size-cells = <1>;
            interrupt-controller;
            #interrupt-cells = <2>;

            input@8000 {
                compatible = "apple,dockchannel-hid";
                reg = <0x8000 0x4000>,
                      <0xc000 0x4000>,
                      <0x0000 0x4000>,
                      <0x4000 0x4000>;
                reg-names = "config", "data", "rmt-config", "rmt-data";
                iommus = <&mtp_dart 0>;
                interrupt-parent = <&mtp_dockchannel>;
                interrupts = <2 IRQ_TYPE_LEVEL_HIGH>,
                             <3 IRQ_TYPE_LEVEL_HIGH>;
                interrupt-names = "tx", "rx";
                apple,fifo-size = <0x800>;
                apple,helper-cpu = <&mtp>;
            };
        };
    };
```

## Documentation/devicetree/bindings/soc/apple/apple,pmp.yaml
```yaml
# SPDX-License-Identifier: (GPL-2.0-only OR BSD-2-Clause)
%YAML 1.2
---
$id: http://devicetree.org/schemas/soc/apple/apple,pmp.yaml#
$schema: http://devicetree.org/meta-schemas/core.yaml#

title: Apple power management co-processor

maintainers:
  - Ryan Murray <ryan@aurorasilicon.org>

description: |
  The PMP runs firmware loaded by the bootloader. Linux starts it through
  RTKit and supplies calibration copied from the Apple device tree. The
  bootloader must initialize the PMP DART address protection filter before
  Linux starts the firmware. Firmware-owned PMC power state must be retained.

properties:
  compatible:
    oneOf:
      - const: apple,t6000-pmp-v2
      - items:
          - enum:
              - apple,t8140-pmp-v2
              - apple,t6034-pmp-v2
          - const: apple,t6000-pmp-v2

  reg:
    items:
      - description: Firmware SRAM
      - description: ASC control registers

  reg-names:
    items:
      - const: pmp
      - const: asc

  mboxes:
    maxItems: 1

  mbox-names:
    const: mbox

  iommus:
    maxItems: 1

  power-domains:
    maxItems: 1

  apple,board-id:
    $ref: /schemas/types.yaml#/definitions/uint32
    description: Board identifier copied by the bootloader.

  apple,dram-vendor-id:
    $ref: /schemas/types.yaml#/definitions/uint32
    description: DRAM vendor identifier copied by the bootloader.

  apple,dram-capacity:
    $ref: /schemas/types.yaml#/definitions/uint32
    description: Firmware DRAM capacity value copied by the bootloader.

  apple,pio-ranges:
    $ref: /schemas/types.yaml#/definitions/uint64-array
    minItems: 2
    description: Host physical address and size pairs mapped into firmware PIO space.

patternProperties:
  '^apple,tunable-':
    $ref: /schemas/types.yaml#/definitions/uint8-array
    description: Opaque firmware calibration copied from the Apple device tree.

required:
  - compatible
  - reg
  - reg-names
  - mboxes
  - mbox-names
  - iommus

additionalProperties: false

examples:
  - |
    soc {
        #address-cells = <2>;
        #size-cells = <2>;

        pmp@300500000 {
            compatible = "apple,t8140-pmp-v2", "apple,t6000-pmp-v2";
            reg = <3 0x00500000 0 0xa0000>, <3 0x00e00000 0 0x4000>;
            reg-names = "pmp", "asc";
            mboxes = <&pmp_mbox>;
            mbox-names = "mbox";
            iommus = <&pmp_dart 0>;
        };
    };
```

## Documentation/devicetree/bindings/soc/apple/apple,rtk-helper-asc4.yaml
```yaml
# SPDX-License-Identifier: (GPL-2.0-only OR BSD-2-Clause)
%YAML 1.2
---
$id: http://devicetree.org/schemas/soc/apple/apple,rtk-helper-asc4.yaml#
$schema: http://devicetree.org/meta-schemas/core.yaml#

title: Apple ASC4 RTKit helper coprocessor

maintainers:
  - Ryan Murray <ryan@aurorasilicon.org>

description:
  Apple SoCs contain a number of ASC coprocessors that run RTKit firmware.
  For some of them the operating system only has to boot the coprocessor and
  keep it running, while the devices it serves are described by other nodes.
  The MTP (multi-touch processor) ASC of Apple laptops is one of these. It
  serves the built-in keyboard and trackpad over DockChannel, and the
  DockChannel HID transport refers to this node through its apple,helper-cpu
  property.

properties:
  compatible:
    items:
      - enum:
          - apple,t6020-mtp
          - apple,t6030-mtp
          - apple,t6031-mtp
          - apple,t6050-mtp
          - apple,t8112-mtp
          - apple,t8122-mtp
          - apple,t8140-mtp
          - apple,t8142-mtp
      - enum:
          - apple,t6020-rtk-helper-asc4
          - apple,t6030-rtk-helper-asc4
          - apple,t8112-rtk-helper-asc4
          - apple,t8122-rtk-helper-asc4
          - apple,t8140-rtk-helper-asc4
          - apple,t8142-rtk-helper-asc4
      - const: apple,mtp
      - const: apple,rtk-helper-asc4

  reg:
    minItems: 1
    items:
      - description: ASC control registers
      - description:
          Coprocessor SRAM, from which the firmware may ask the host to map
          buffers instead of allocating them from system memory

  reg-names:
    minItems: 1
    items:
      - const: asc
      - const: sram

  mboxes:
    maxItems: 1

  iommus:
    maxItems: 1

  '#helper-cells':
    const: 0
    description:
      Present in existing device trees. Nothing references the helper with
      argument cells; the DockChannel HID transport uses a plain phandle.

required:
  - compatible
  - reg
  - reg-names
  - mboxes
  - iommus

additionalProperties: false

examples:
  - |
    soc {
        #address-cells = <2>;
        #size-cells = <2>;

        mtp@314600000 {
            compatible = "apple,t8140-mtp", "apple,t8140-rtk-helper-asc4",
                         "apple,mtp", "apple,rtk-helper-asc4";
            reg = <0x3 0x14600000 0x0 0x4000>,
                  <0x3 0x14050000 0x0 0x4000>;
            reg-names = "asc", "sram";
            mboxes = <&mtp_mbox>;
            iommus = <&mtp_dart 0>;
        };
    };
```
